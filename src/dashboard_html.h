#pragma once

// GENERATED by tools/build_web.py from web/. Edit the files in web/, not this header.
inline constexpr char kDashboardHtml[] = R"HTML(<!doctype html>
<html lang="en">
<head>
<meta charset="utf-8">
<meta name="viewport" content="width=device-width,initial-scale=1,viewport-fit=cover">
<title>Jiggler</title>
<meta name="color-scheme" content="light dark">
<meta name="theme-color" content="#f3f1ec" media="(prefers-color-scheme: light)">
<meta name="theme-color" content="#131512" media="(prefers-color-scheme: dark)">
<meta name="mobile-web-app-capable" content="yes">
<meta name="apple-mobile-web-app-capable" content="yes">
<meta name="apple-mobile-web-app-title" content="Jiggler">
<meta name="apple-mobile-web-app-status-bar-style" content="default">
<link rel="manifest" href="/manifest.webmanifest">
<link rel="icon" type="image/png" href="/icon-192.png">
<link rel="apple-touch-icon" href="/apple-touch-icon.png">
<style>
:root{
  --bg:#f3f1ec;--surface:#fbfaf7;--text:#1d1b17;--muted:#6b665c;--line:#dedad0;
  --accent:#0e7c66;--on-accent:#fff;--bad:#b3261e;--warn:#8a5a00;--ok:#0e7c66;
  --s1:4px;--s2:8px;--s3:12px;--s4:16px;--s5:24px;--s6:32px;--s7:48px;
  --radius:12px;--nav-h:64px;
  --ease:cubic-bezier(.22,1,.36,1);
}
@media (prefers-color-scheme:dark){:root:not([data-theme=light]){
  --bg:#131512;--surface:#1b1d19;--text:#ecebe5;--muted:#a5a396;--line:#2c2f29;
  --accent:#4fd1b0;--on-accent:#07251d;--bad:#ff8a80;--warn:#f0b429;--ok:#4fd1b0}}
*{box-sizing:border-box}
html{-webkit-text-size-adjust:100%}
body{margin:0;background:var(--bg);color:var(--text);font:16px/1.5 system-ui,-apple-system,"Segoe UI",Roboto,sans-serif;
  padding-bottom:calc(var(--nav-h) + env(safe-area-inset-bottom));min-height:100vh}
[hidden]{display:none!important}
.sr{position:absolute;width:1px;height:1px;overflow:hidden;clip:rect(0 0 0 0);white-space:nowrap}
h1,h2,p,dl,dd,ul{margin:0;padding:0}
h1:focus{outline:none}
h1{font-size:1.5rem;line-height:1.2;font-weight:650;margin-bottom:var(--s4)}
h2{font-size:1.0625rem;font-weight:650;margin-bottom:var(--s2)}
.shell{max-width:44rem;margin:0 auto;padding:0 var(--s4)}
.brand{display:flex;align-items:center;gap:var(--s2);font-weight:650;font-size:1.0625rem;padding:max(var(--s4),env(safe-area-inset-top)) 0 var(--s3)}
.logo{width:20px;height:20px;color:var(--accent)}

/* Navigation: bottom bar on phones, left rail on wide screens */
.nav{position:fixed;left:0;right:0;bottom:0;display:flex;background:var(--surface);border-top:1px solid var(--line);
  padding-bottom:env(safe-area-inset-bottom);z-index:5}
.nav a{flex:1;display:flex;flex-direction:column;align-items:center;justify-content:center;gap:2px;min-height:var(--nav-h);
  color:var(--muted);text-decoration:none;font-size:.75rem;font-weight:600}
.nav svg{width:22px;height:22px;fill:none;stroke:currentColor;stroke-width:1.7;stroke-linecap:round;stroke-linejoin:round}
.nav a[aria-current=page]{color:var(--accent)}
.nav a:focus-visible,button:focus-visible,input:focus-visible,select:focus-visible,textarea:focus-visible,summary:focus-visible{
  outline:2px solid var(--accent);outline-offset:2px}
@media (min-width:860px){
  body{padding-bottom:0}
  .shell{max-width:62rem;display:grid;grid-template-columns:12rem minmax(0,1fr);column-gap:var(--s6);align-items:start}
  .brand{grid-column:1;padding-top:var(--s6)}
  .nav{position:static;grid-column:1;flex-direction:column;background:none;border:0;padding:0;gap:var(--s1)}
  .nav a{flex-direction:row;justify-content:flex-start;gap:var(--s3);min-height:44px;padding:0 var(--s3);border-radius:10px;font-size:.9375rem}
  .nav a[aria-current=page]{background:var(--surface);box-shadow:0 0 0 1px var(--line)}
  main{grid-column:2;grid-row:1/span 3;padding-top:var(--s6);max-width:40rem}
}

/* Content */
main{padding-bottom:var(--s6)}
.view>*+*{margin-top:var(--s5)}
.block{border-top:1px solid var(--line);padding-top:var(--s4)}
.view>h1+.block,.view>h1.sr+.hero+.block{border-top:0;padding-top:0}
.view>.hero+.block{border-top:0}
details.block summary{cursor:pointer;list-style:none;display:flex;align-items:center;justify-content:space-between;min-height:44px}
details.block summary::-webkit-details-marker{display:none}
details.block summary h2{margin:0}
details.block summary::after{content:"+";font-size:1.25rem;color:var(--muted);width:24px;text-align:center}
details.block[open] summary::after{content:"–"}
details.block[open] summary{margin-bottom:var(--s2)}
.block>p+form,.block>p+.field{margin-top:var(--s3)}
.hint{color:var(--muted);font-size:.875rem;margin-top:var(--s2);max-width:65ch}
.note{color:var(--muted);font-size:.875rem;margin-top:var(--s3)}
.empty{color:var(--muted);padding:var(--s3) 0}
.banner{margin-bottom:var(--s4);padding:var(--s3) var(--s4);border-radius:10px;background:var(--surface);border:1px solid var(--line);font-size:.9375rem}
.banner.bad{border-color:var(--bad);color:var(--bad)}
.banner.good{border-color:var(--ok);color:var(--ok)}

/* Connection hero */
.hero{--tone:var(--muted);background:var(--surface);border:1px solid var(--line);border-radius:var(--radius);padding:var(--s5) var(--s4);
  box-shadow:0 1px 2px rgb(0 0 0/.04),0 6px 18px rgb(0 0 0/.05)}
.hero[data-tone=ok]{--tone:var(--ok);background:color-mix(in srgb,var(--accent) 8%,var(--surface))}
.hero[data-tone=open]{--tone:var(--accent);background:color-mix(in srgb,var(--accent) 8%,var(--surface))}
.hero[data-tone=warn]{--tone:var(--warn)}
.hero-head{display:flex;gap:var(--s3);align-items:flex-start}
.pulse{flex:none;width:14px;height:14px;border-radius:50%;background:var(--tone);margin-top:.55rem;position:relative}
.hero[data-tone=ok] .pulse::after,.hero[data-tone=open] .pulse::after{content:"";position:absolute;inset:0;border-radius:50%;
  background:var(--tone);animation:pulse 2.4s var(--ease) infinite}
@keyframes pulse{from{transform:scale(1);opacity:.55}to{transform:scale(3);opacity:0}}
@media (prefers-reduced-motion:reduce){.hero .pulse::after{animation:none!important}}
.hero-title{font-size:1.75rem;line-height:1.2;font-weight:700;text-wrap:balance}
.hero-detail{color:var(--muted);margin-top:var(--s1);max-width:50ch}
.hero-actions{display:flex;gap:var(--s2);flex-wrap:wrap;margin-top:var(--s4)}
.hero-actions:empty{display:none}
body.offline .hero{opacity:.55}
.hero .msg:empty,.hero .note:empty{display:none}
.runfor[hidden]{display:none}

/* Movement block */
.state{font-size:1.375rem;font-weight:650}
.sub{color:var(--muted);font-variant-numeric:tabular-nums;margin-top:2px}
.actions{display:flex;gap:var(--s2);flex-wrap:wrap;margin-top:var(--s3)}
.facts{margin-top:var(--s4);display:grid;gap:var(--s2)}
.facts>div{display:flex;justify-content:space-between;gap:var(--s4);padding:var(--s2) 0;border-bottom:1px solid var(--line)}
.facts dt{color:var(--muted)}
.facts dd{font-variant-numeric:tabular-nums;text-align:right;overflow-wrap:anywhere}

/* First-time setup */
.setup{background:var(--surface);border:1px solid var(--line);border-radius:var(--radius);padding:var(--s5) var(--s4);box-shadow:0 1px 2px rgb(0 0 0/.04),0 6px 18px rgb(0 0 0/.05)}
.setup-title{font-size:1.5rem;line-height:1.2;font-weight:700;margin:0 0 var(--s2);text-wrap:balance}
.setup-lead{color:var(--muted);max-width:46ch}
.steps{list-style:none;margin:var(--s5) 0 0;padding:0;display:grid;gap:var(--s4)}
.step{display:grid;grid-template-columns:2rem 1fr;gap:var(--s3);align-items:start;opacity:.55}
.step.active,.step.done{opacity:1}
.step .num{display:grid;place-items:center;width:2rem;height:2rem;border-radius:50%;border:1.5px solid var(--line);font-weight:650;font-size:.9375rem;color:var(--muted)}
.step.active .num{border-color:var(--accent);background:var(--accent);color:var(--on-accent)}
.step.done .num{border-color:var(--ok);color:var(--ok)}
.step-title{font-weight:650;margin-top:.2rem}
.step-text{color:var(--muted);font-size:.9375rem;margin-top:var(--s1);max-width:50ch}
.step .actions{margin-top:var(--s3)}
.step .msg:empty{display:none}
.waiting{display:flex;align-items:center;gap:var(--s2);margin-top:var(--s3);font-weight:600;color:var(--accent)}
.waiting .pulse{margin:0;width:10px;height:10px;background:var(--accent)}
.waiting .pulse::after{content:"";position:absolute;inset:0;border-radius:50%;background:var(--accent);animation:pulse 2.4s var(--ease) infinite}
@media (prefers-reduced-motion:reduce){.waiting .pulse::after{animation:none!important}}

progress{width:100%;height:10px;margin:var(--s2) 0;accent-color:var(--accent)}
code{font:.875em ui-monospace,SFMono-Regular,Menlo,monospace}

/* Run for */
.runfor{display:flex;gap:var(--s3);flex-wrap:wrap;margin-top:var(--s4);align-items:flex-end}
.runfor .field{margin:0;min-width:10rem;flex:1 1 10rem}
.runfor+.err{margin-top:var(--s1)}

/* Schedules */
#clockNote{margin-bottom:var(--s3)}
.hint.lead{margin-top:0;margin-bottom:var(--s3)}
ul.hint.plain{padding-left:1.2rem;list-style:disc}
ul.hint.plain li{margin:.2rem 0}
.sched{border:1px solid var(--line);border-radius:10px;padding:var(--s3);margin-bottom:var(--s3);background:var(--surface)}
.sched-head{display:flex;justify-content:space-between;align-items:center;gap:var(--s3);margin-bottom:var(--s2)}
.sched-sum{font-weight:650}
.sched-sum.off{color:var(--muted);font-weight:500}
.days{display:flex;gap:var(--s1);flex-wrap:wrap;margin-bottom:var(--s3)}
.days button{min-height:40px;min-width:44px;padding:0 var(--s2);border-radius:8px;font-size:.875rem;font-weight:600}
.days button[aria-pressed=true]{background:var(--accent);color:var(--on-accent);border-color:transparent}
.sched .row3{display:grid;grid-template-columns:1fr 1fr;gap:var(--s3)}
.sched>.hint{margin:0 0 var(--s3)}

/* Controls */
button,select,textarea,input{font:inherit}
button{min-height:44px;padding:0 var(--s4);border-radius:10px;border:1px solid var(--line);background:var(--surface);color:var(--text);cursor:pointer;
  transition:background-color .15s,border-color .15s,transform .1s var(--ease)}
button:hover:not(:disabled){border-color:var(--muted)}
button:active:not(:disabled){transform:translateY(1px)}
button:disabled{opacity:.45;cursor:not-allowed}
button.primary{background:var(--accent);color:var(--on-accent);border-color:transparent;font-weight:600}
button.primary:hover:not(:disabled){filter:brightness(1.06);border-color:transparent}
button.danger{color:var(--bad)}
button.danger.confirm{background:var(--bad);color:#fff;border-color:transparent}
button.link{border:0;background:none;min-height:36px;padding:0 var(--s2);color:var(--accent);font-weight:600}
button.link.danger{color:var(--bad)}
button.link.danger.confirm{background:var(--bad);color:#fff}
.field{margin-bottom:var(--s3)}
label{display:block;font-size:.875rem;font-weight:600;margin-bottom:var(--s1)}
label.inline{display:flex;align-items:center;gap:var(--s2);font-weight:400;font-size:1rem}
input,select,textarea{width:100%;min-height:44px;padding:var(--s2) var(--s3);border-radius:10px;border:1px solid var(--line);background:var(--surface);color:var(--text)}
input::placeholder,textarea::placeholder{color:var(--muted);opacity:1}
input[type=checkbox]{width:20px;height:20px;min-height:0;accent-color:var(--accent)}
textarea{min-height:14rem;font:13px/1.45 ui-monospace,SFMono-Regular,Menlo,monospace;resize:vertical}
input[aria-invalid=true]{border-color:var(--bad)}
.row{display:grid;grid-template-columns:1fr 1fr;gap:var(--s3)}
.inline-form{margin-top:var(--s3);display:flex;gap:var(--s3);align-items:flex-end;flex-wrap:wrap}
.inline-form .field{margin:0;min-width:9rem}
.err{color:var(--bad);font-size:.875rem;min-height:1.25em;margin-top:2px}
.msg{min-height:1.5em;margin-top:var(--s2);font-size:.9375rem}
.msg.bad{color:var(--bad)}.msg.good{color:var(--ok)}

/* Lists */
.list{list-style:none}
.list>li{padding:var(--s3) 0;border-bottom:1px solid var(--line)}
.peer-top{display:flex;align-items:center;justify-content:space-between;gap:var(--s3);flex-wrap:wrap}
.peer-name{font-weight:650}
.peer-meta{color:var(--muted);font-size:.875rem}
.peer-live{color:var(--ok);font-weight:600}
.peer-actions{display:flex;gap:var(--s1);flex-wrap:wrap}
.peer-edit{display:flex;gap:var(--s2);margin-top:var(--s2)}
.peer-edit input{flex:1}
.dev{border:1px solid var(--line);border-radius:10px;padding:var(--s3);margin-bottom:var(--s3)}
.dev h3{margin:0 0 var(--s2);font-size:1rem}

/* Login */
.login{position:fixed;inset:0;z-index:20;display:flex;align-items:center;justify-content:center;padding:var(--s4);background:color-mix(in srgb,var(--bg) 82%,transparent);
  -webkit-backdrop-filter:blur(8px);backdrop-filter:blur(8px)}
.panel{width:100%;max-width:22rem;background:var(--surface);border:1px solid var(--line);border-radius:var(--radius);padding:var(--s5);
  box-shadow:0 2px 4px rgb(0 0 0/.05),0 12px 32px rgb(0 0 0/.12)}
.panel .field{margin-top:var(--s4)}

a.linkbtn{display:inline-flex;align-items:center;min-height:2.75rem;padding:0 var(--s2);color:var(--accent);font-weight:600;text-decoration:none}
a.linkbtn:hover{text-decoration:underline}
.facts a{color:var(--accent);text-decoration:none}
.facts a:hover{text-decoration:underline}
</style>
</head>
<body>
<div class="shell">
<header class="brand">
<svg class="logo" viewBox="0 0 24 24" aria-hidden="true"><path d="M7 4v14l3.5-3.5L13 20l2.2-1-2.5-5.5H18z" fill="currentColor"/></svg>
<span>Jiggler</span>
</header>

<nav class="nav" id="nav" aria-label="Sections">
<a href="#status" data-view="status"><svg viewBox="0 0 24 24" aria-hidden="true"><circle cx="12" cy="12" r="8"/><path d="M12 7.5V12l3 2"/></svg><span>Status</span></a>
<a href="#computers" data-view="computers"><svg viewBox="0 0 24 24" aria-hidden="true"><rect x="3.5" y="5" width="17" height="11" rx="1.5"/><path d="M8 20h8M12 16v4"/></svg><span>Computers</span></a>
<a href="#device" data-view="device"><svg viewBox="0 0 24 24" aria-hidden="true"><path d="M4 12h16M4 12l3-3M4 12l3 3M20 12l-3-3M20 12l-3 3"/></svg><span>Device</span></a>
<a href="#schedule" data-view="schedule"><svg viewBox="0 0 24 24" aria-hidden="true"><rect x="4" y="5.5" width="16" height="14" rx="2"/><path d="M4 10h16M9 3.5v4M15 3.5v4"/></svg><span>Schedule</span></a>
<a href="#system" data-view="system"><svg viewBox="0 0 24 24" aria-hidden="true"><path d="M5 7h14M5 12h14M5 17h14"/><circle cx="9" cy="7" r="1.6"/><circle cx="15" cy="12" r="1.6"/><circle cx="8" cy="17" r="1.6"/></svg><span>System</span></a>
</nav>

<main id="main">
<div id="banner" class="banner" role="status" aria-live="polite" hidden></div>

<section class="view" id="view-status" aria-labelledby="h-status">
<h1 class="sr" id="h-status">Status</h1>
<div class="setup" id="setup" hidden>
<h2 class="setup-title">Set up your Jiggler</h2>
<p class="setup-lead">Three steps and your first computer is connected. The jiggler cannot run until one is paired.</p>
<ol class="steps">
<li class="step done"><span class="num" aria-hidden="true">✓</span>
<div><p class="step-title">Connect to the device</p>
<p class="step-text">You are here, so WiFi and your token are set.</p></div></li>
<li class="step" id="stepPair"><span class="num" aria-hidden="true">2</span>
<div><p class="step-title">Start Discovery</p>
<p class="step-text" id="setupPairText">Discovery is closed, so nobody can pair by accident. Open it for a few minutes. You can also hold the button on the board for 5 to 10 seconds (the LED blinks fast), then let go.</p>
<div class="actions"><button class="primary" id="setupOpen">Start Discovery</button><button id="setupStop" hidden>Stop Discovery</button></div>
<p class="msg" id="setupMsg" role="status" aria-live="polite"></p></div></li>
<li class="step" id="stepChoose"><span class="num" aria-hidden="true">3</span>
<div><p class="step-title">Choose the device on your computer</p>
<p class="step-text">Open the Bluetooth settings and pick <b id="setupName">the device</b>. This page updates by itself when it connects.</p>
<p class="waiting" id="setupWait" hidden><span class="pulse" aria-hidden="true"></span>Waiting for a computer…</p></div></li>
</ol>
</div>

<div class="hero" id="hero" data-tone="idle">
<div class="hero-head">
<span class="pulse" aria-hidden="true"></span>
<div>
<p class="hero-title" id="heroTitle">Connecting…</p>
<p class="hero-detail" id="heroDetail">&nbsp;</p>
</div>
</div>
<div class="hero-actions" id="heroActions"></div>
<p class="note" id="heroNote"></p>
<p class="msg" id="heroMsg" role="status" aria-live="polite"></p>
</div>

<div class="block" id="movementBlock">
<h2>Movement</h2>
<p class="state" id="state">—</p>
<p class="sub" id="next">&nbsp;</p>
<p class="note" id="schedNote" hidden></p>
<p class="note" id="updNote" hidden></p>
<div class="runfor" id="runFor">
<div class="field"><label for="runChoice">Run for</label>
<select id="runChoice">
<option value="forever">Until I stop it</option>
<option value="5">5 minutes</option>
<option value="10">10 minutes</option>
<option value="30">30 minutes</option>
<option value="60">1 hour</option>
<option value="until">Until a time…</option>
<option value="custom">Custom…</option>
</select></div>
<div class="field" id="runUntilBox" hidden><label for="runUntil">Until</label><input id="runUntil" type="time"></div>
<div class="field" id="runCustomBox" hidden><label for="runCustom">Minutes</label><input id="runCustom" inputmode="numeric" autocomplete="off" placeholder="1 to 1440"></div>
</div>
<div class="err" id="runErr"></div>
<div class="runfor" id="pauseFor" hidden>
<div class="field"><label for="pauseChoice">Pause for</label>
<select id="pauseChoice">
<option value="15">15 minutes</option>
<option value="30">30 minutes</option>
<option value="60">1 hour</option>
<option value="120">2 hours</option>
<option value="0">Until I resume</option>
</select></div>
</div>
<div class="actions">
<button id="bToggle" class="primary">Start</button>
<button id="bPause" hidden>Pause</button>
<button id="bResume" class="primary" hidden>Resume</button>
<button id="bMove">Move now</button>
</div>
<p class="msg" id="msg" role="status" aria-live="polite"></p>
<dl class="facts">
<div><dt>Last movement</dt><dd id="last">—</dd></div>
<div><dt>Movements made</dt><dd id="count">0</dd></div>
<div><dt>Device clock</dt><dd id="clock">—</dd></div>
<div><dt>WiFi</dt><dd id="wifi">—</dd></div>
</dl>
</div>
</section>

<section class="view" id="view-computers" aria-labelledby="h-computers" hidden>
<h1 id="h-computers">Computers</h1>
<div class="block">
<h2>Bluetooth</h2>
<p id="btInfo">&nbsp;</p>
<div class="actions"><button id="btToggle">Turn Bluetooth off</button></div>
<p class="msg" id="btMsg" role="status" aria-live="polite"></p>
<p class="hint"><b>Off</b>: the radio is silent, nothing can see or reach the device. <b>Waiting</b>: on; only computers that are already paired can find it and connect. <b>Discovery</b>: open for a few minutes so a new computer can pair. <b>Connected</b>: linked to a computer.</p>
</div>

<div class="block">
<h2>Discovery</h2>
<p id="pairInfo">&nbsp;</p>
<div class="actions">
<button class="primary" id="pairOpen">Start Discovery</button>
<button id="pairClose">Stop Discovery</button>
</div>
<p class="msg" id="pairMsg" role="status" aria-live="polite"></p>
<div class="field"><label for="discSeconds">Discovery lasts (seconds)</label><input id="discSeconds" inputmode="numeric" autocomplete="off"><div class="err" data-err="discoverySeconds"></div></div>
<label class="inline"><input type="checkbox" id="offOnDisc"> Turn Bluetooth off when the computer itself disconnects</label>
<p class="hint">30 to 600 seconds. While Discovery is closed, only computers that are already paired can connect, so nobody else can pair. It closes by itself when the time is up or as soon as a computer pairs. To open it from the board, hold the button for 5 to 10 seconds and let go. A computer that ends the connection from its own Bluetooth menu (Disconnect), goes to sleep or turns Bluetooth off reconnects by itself when it comes back, like any other mouse. Tick the box to switch Bluetooth off instead, until you turn it on again: Disconnect then sticks, but a computer that disconnects when it sleeps cannot reconnect after waking until you switch Bluetooth on.</p>
<div class="actions"><button id="discSave">Save</button></div>
<p class="msg" id="discMsg" role="status" aria-live="polite"></p>
</div>

<div class="block">
<h2>Paired computers</h2>
<ul class="list" id="peers"></ul>
<p class="empty" id="peersEmpty" hidden>No computer paired. Start Discovery above, then choose the device in the computer’s Bluetooth settings.</p>
<div class="actions"><button class="danger" id="forgetAll">Forget all</button></div>
<p class="msg" id="peersMsg" role="status" aria-live="polite"></p>
<p class="hint">Bluetooth does not tell the device a computer’s name, so they are numbered. To tell them apart: disconnect, see which computer loses the mouse, and rename it here. Up to 3 computers can be paired.</p>
</div>
</section>

<section class="view" id="view-device" aria-labelledby="h-device" hidden>
<h1 id="h-device">Device</h1>

<div class="block">
<h2>Movement</h2>
<form id="cfg" novalidate>
<div class="row">
<div class="field"><label for="minIntervalSec">Minimum interval (s)</label><input id="minIntervalSec" inputmode="numeric" autocomplete="off"><div class="err" id="e_minIntervalSec"></div></div>
<div class="field"><label for="maxIntervalSec">Maximum interval (s)</label><input id="maxIntervalSec" inputmode="numeric" autocomplete="off"><div class="err" id="e_maxIntervalSec"></div></div>
</div>
<div class="field"><label for="amplitudePx">Movement size (px)</label><input id="amplitudePx" inputmode="numeric" autocomplete="off"><div class="err" id="e_amplitudePx"></div></div>
<div class="row">
<div class="field"><label for="clickProbability">Random clicks (%)</label><input id="clickProbability" inputmode="decimal" autocomplete="off"><div class="err" id="e_clickProbability"></div></div>
<div class="field"><label for="scrollProbability">Random scrolls (%)</label><input id="scrollProbability" inputmode="decimal" autocomplete="off"><div class="err" id="e_scrollProbability"></div></div>
</div>
<p class="hint">Intervals 5–3600 s, size 5–600 px. A random click is always a left click, and it can activate whatever is under the cursor: leave it at 0% if you do not need it.</p>
<div class="actions"><button class="primary" type="submit">Save</button></div>
<p id="cfgMsg" class="msg" role="status" aria-live="polite"></p>
</form>
</div>

<div class="block" id="appearanceBox">
<h2>Appearance</h2>
<p class="hint lead">How the device introduces itself to computers over Bluetooth. Pick Custom or a real mouse model, then change any detail you like. A field left empty uses the model's value (shown in grey).</p>
<div class="field"><label for="apModel">Shown as</label><select id="apModel"></select><div class="err" data-err="profile"></div></div>
<div class="field"><label for="apName">Name</label><input id="apName" maxlength="29" autocomplete="off"><div class="err" data-err="name"></div></div>
<div class="field"><label for="apManufacturer">Manufacturer</label><input id="apManufacturer" maxlength="32" autocomplete="off"><div class="err" data-err="manufacturer"></div></div>
<div class="row">
<div class="field"><label for="apVid">Vendor ID (VID)</label><input id="apVid" autocomplete="off" spellcheck="false"><div class="err" data-err="vid"></div></div>
<div class="field"><label for="apPid">Product ID (PID)</label><input id="apPid" autocomplete="off" spellcheck="false"><div class="err" data-err="pid"></div></div>
</div>
<div class="field"><label for="apMac">Bluetooth address</label><input id="apMac" autocomplete="off" spellcheck="false"><div class="err" data-err="mac"></div>
<p class="hint">Like AA:BB:CC:DD:EE:FF, with an even first byte. Empty keeps the model's vendor prefix and the chip's own last three bytes (Custom: the chip's own address). Setting one also changes the board's WiFi address. VID and PID are hexadecimal (0x046D) or decimal.</p></div>
<p class="note" id="apNow">&nbsp;</p>
<p class="hint"><b>Changing this restarts the device.</b> Computers already paired will not recognise it afterwards: on each one, remove the device in its Bluetooth settings, then pair it again from Computers → Open pairing.</p>
<div class="actions"><button class="primary" id="apApply">Apply and restart</button></div>
<p id="apMsg" class="msg" role="status" aria-live="polite"></p>
</div>

</section>

<section class="view" id="view-schedule" aria-labelledby="h-schedule" hidden>
<h1 id="h-schedule">Schedule</h1>
<div class="block">
<h2>Weekly schedules</h2>
<p class="hint lead">A <b>window</b> runs the jiggler from a start time to an end time. An <b>action</b> does one thing at one time: start, stop, pause, resume, turn Bluetooth on or off, or open Discovery. Add a random shift and the times move a little every day. Stopping or starting by hand is respected until the next window opens or closes. A window that is open when you save it starts at once.</p>
<p class="sub" id="clockNote">&nbsp;</p>
<div id="schedList"></div>
<p class="empty" id="schedEmpty" hidden>No schedules. Add a window to run the jiggler between two times, or an action to do one thing at a time.</p>
<div class="actions"><button id="schedAdd">Add window</button><button id="schedAddAction">Add action</button><button class="primary" id="schedSave">Save schedules</button></div>
<p id="schedMsg" class="msg" role="status" aria-live="polite"></p>
</div>

</section>

<section class="view" id="view-system" aria-labelledby="h-system" hidden>
<h1 id="h-system">System</h1>

<div class="block">
<h2>Security</h2>
<p>The token protects the dashboard, the API and MCP. Change it if it has been shared.</p>
<form id="tokenForm" novalidate>
<div class="field"><label for="tokCurrent">Current token</label><input id="tokCurrent" type="password" autocomplete="current-password"><div class="err" data-err="current"></div></div>
<div class="field"><label for="tokNew">New token</label><input id="tokNew" type="password" autocomplete="new-password"><div class="err" data-err="token"></div></div>
<div class="field"><label for="tokConfirm">Repeat the new token</label><input id="tokConfirm" type="password" autocomplete="new-password"><div class="err" data-err="confirm"></div></div>
<div class="actions"><button class="primary" type="submit">Change token</button></div>
<p id="tokMsg" class="msg" role="status" aria-live="polite"></p>
</form>
</div>

<div class="block" id="timeBox">
<h2>Time</h2>
<p class="hint lead">Schedules follow this clock. It comes from the internet (NTP); a board with no internet loses the time at every restart and needs it set by hand.</p>
<p class="note" id="timeNow">&nbsp;</p>
<div class="field"><label for="tzSelect">Timezone</label><select id="tzSelect"></select><div class="err" data-err="timezone"></div></div>
<div class="field"><label for="ntpServer">NTP server</label><input id="ntpServer" autocomplete="off" spellcheck="false" placeholder="pool.ntp.org"><div class="err" data-err="ntpServer"></div>
<p class="hint">A host name such as pool.ntp.org. Leave it empty to stop using the internet for the time.</p></div>
<div class="actions"><button class="primary" id="timeSave">Save</button><button id="timeSet">Set the time from this browser</button></div>
<p id="timeMsg" class="msg" role="status" aria-live="polite"></p>
</div>

<div class="block" id="buttonBox">
<h2>Button</h2>
<p class="hint lead">A button on the board (to ground) starts and stops the jiggler. The default is the BOOT button, GPIO 0.</p>
<div class="field"><label for="btnGpio">GPIO</label><select id="btnGpio"></select><div class="err" data-err="gpio"></div></div>
<ul class="hint plain"><li><b>Tap</b>: start or stop the jiggler (the LED blinks three times).</li><li><b>Hold 5 to 10 seconds, then let go</b>: open Discovery. The LED blinks fast while you can let go.</li><li><b>Hold 10 to 30 seconds</b>: nothing happens when you let go (the LED is dark).</li><li><b>Hold 30 seconds</b>: switch between home WiFi and own-network mode and restart.</li></ul>
<div class="actions"><button class="primary" id="btnSave">Save</button></div>
<p id="btnMsg" class="msg" role="status" aria-live="polite"></p>
</div>

<div class="block">
<h2>Network</h2>
<p class="hint"><b>Auto</b>: connects to your home WiFi and, if it cannot, opens the setup network. <b>Own network</b>: creates a protected WiFi network that serves this dashboard (address 192.168.4.1), for places without WiFi. Holding the button for 30 seconds switches between the two. Changes apply after a restart. Without internet the clock has to be set by hand (Time).</p>
<div class="field"><label for="netMode">Mode</label><select id="netMode"><option value="auto">Auto (home WiFi)</option><option value="ap">Own network</option></select><div class="err" data-err="mode"></div></div>
<div class="field"><label for="netSsid">Own network name</label><input id="netSsid" autocomplete="off"><div class="err" data-err="apSsid"></div></div>
<div class="field"><label for="netPass">Own network password</label><input id="netPass" autocomplete="off"><div class="err" data-err="apPassword"></div><p class="hint">Optional, 8 to 63 characters. Leave it empty and one is generated the first time the own network starts.</p></div>
<div class="actions"><button id="netSave">Save</button><button class="primary" id="netSaveRestart">Save and restart</button></div>
<p id="netMsg" class="msg" role="status" aria-live="polite"></p>
</div>

<div class="block" id="updBox">
<h2>Firmware updates</h2>
<p class="note" id="updVersion">&nbsp;</p>
<p id="updInfo">&nbsp;</p>
<progress id="updProgress" max="100" value="0" hidden aria-label="Download progress"></progress>
<div class="actions"><button id="updCheck">Check for updates</button><button class="primary" id="updInstall" hidden>Install</button><a class="linkbtn" id="updNotes" href="#" target="_blank" rel="noopener" hidden>Release notes</a></div>
<p id="updMsg" class="msg" role="status" aria-live="polite"></p>
<div class="field"><label for="updMode">When a new version is released</label>
<select id="updMode"><option value="manual">Tell me, and I install it</option><option value="automatic">Install it automatically</option><option value="ignore">Ignore it</option></select>
<div class="err" data-err="mode"></div></div>
<p class="hint" id="updModeHint"></p>
<div class="field" id="updTimeBox"><label for="updTime">Look for updates at</label><input id="updTime" type="time"><div class="err" data-err="checkTime"></div></div>
<p class="hint" id="updTimeHint">The time of day, on the device’s clock and timezone (System → Time). Pick a quiet hour: with automatic updates the device restarts when it installs.</p>
<div class="field"><label for="updRepo">Repository to get releases from</label><input id="updRepo" autocomplete="off" spellcheck="false" placeholder="https://github.com/owner/repo"><div class="err" data-err="repoUrl"></div></div>
<p class="hint">A GitHub repository address. The device downloads the firmware file <code>jiggler-esp32.bin</code> of its latest release over HTTPS, checks the connection’s certificate, and checks the file against its <code>.sha256</code> when the release has one. Only install firmware from a repository you trust: whoever controls it controls this device. The clock must be set (System → Time).</p>
<div class="actions"><button class="primary" id="updSave">Save</button><button id="updReset">Use the default</button></div>
<p id="updSaveMsg" class="msg" role="status" aria-live="polite"></p>
</div>

<div class="block" id="fwBox">
<h2>Install from a file</h2>
<p class="hint lead">Replace the firmware over WiFi with a file built from this project. Your token, WiFi, pairings and schedules are kept.</p>
<div class="field"><label for="fwFile">Firmware file (.bin)</label><input id="fwFile" type="file" accept=".bin"><div class="err" id="e_fwFile"></div></div>
<progress id="fwProgress" max="100" value="0" hidden aria-label="Upload progress"></progress>
<div class="actions"><button class="primary" id="fwUpload">Upload and restart</button></div>
<p id="fwMsg" class="msg" role="status" aria-live="polite"></p>
<p class="hint">Build the file with <code>pio run -e esp32</code>; it is <code>.pio/build/esp32/firmware.bin</code>. A file that is not a valid ESP32 firmware is refused and nothing changes. A firmware that starts but is broken in another way can only be recovered with a USB cable.</p>
</div>

<div class="block">
<h2>About this device</h2>
<dl class="facts">
<div><dt>Version</dt><dd id="infoVersion">—</dd></div>
<div><dt>Bluetooth name</dt><dd id="infoName">—</dd></div>
<div><dt>Bluetooth address</dt><dd id="infoAddress">—</dd></div>
<div><dt>Source code</dt><dd><a id="infoRepo" href="https://github.com/carlosatta/jiggler" target="_blank" rel="noopener">github.com/carlosatta/jiggler</a></dd></div>
</dl>
<div class="actions"><button id="restartBtn">Restart</button></div>
<p id="sysMsg" class="msg" role="status" aria-live="polite"></p>
<p class="hint" id="installHint">To use it as an app, choose “Add to Home Screen” in your browser’s menu. On a phone it then opens full screen; full installation needs HTTPS, which a board on a local network cannot offer.</p>
</div>
</section>
</main>
</div>

<div id="login" class="login" role="dialog" aria-modal="true" aria-labelledby="loginTitle" hidden>
<form class="panel" id="loginForm">
<h2 id="loginTitle">Sign in</h2>
<p class="hint">Enter the API token. It is the one you chose during setup; in own-network mode it is the device’s WiFi password.</p>
<div class="field"><label for="tokenInput">API token</label><input id="tokenInput" type="password" autocomplete="current-password"><div class="err" id="loginErr"></div></div>
<label class="inline"><input type="checkbox" id="tokenShow"> Show the token</label>
<div class="actions"><button class="primary" type="submit">Sign in</button></div>
</form>
</div>

<script>
// Pure helpers (no DOM): inlined before core.js in the page and loaded as a module by the node tests.
var JigLib = (function () {
  'use strict';

  var DAYS = ['mon', 'tue', 'wed', 'thu', 'fri', 'sat', 'sun'];
  var DAY_LABELS = { mon: 'Mon', tue: 'Tue', wed: 'Wed', thu: 'Thu', fri: 'Fri', sat: 'Sat', sun: 'Sun' };

  // Server messages are short English fragments ("must be between 5 and 3600"); show them as sentences.
  function tr(message) {
    if (!message) return 'Invalid value.';
    var s = String(message);
    s = s.charAt(0).toUpperCase() + s.slice(1);
    return /[.!?]$/.test(s) ? s : s + '.';
  }

  function pad2(n) { return (n < 10 ? '0' : '') + n; }
  function plural(n, one, many) { return n + ' ' + (n === 1 ? one : many); }

  function fmtDuration(ms) {
    var s = Math.ceil(ms / 1000), h = Math.floor(s / 3600), m = Math.floor((s % 3600) / 60), sec = s % 60;
    return h > 0 ? h + ':' + pad2(m) + ':' + pad2(sec) : m + ':' + pad2(sec);
  }

  function fmtAgo(ms) {
    var m = Math.floor(ms / 60000);
    if (m < 1) return 'less than a minute ago';
    return plural(m, 'minute', 'minutes') + ' ago';
  }

  // A length of time, as in "for 12 minutes" / "for 1 hour 5 min".
  function fmtSince(ms) {
    var m = Math.floor(ms / 60000);
    if (m < 1) return 'less than a minute';
    if (m < 60) return plural(m, 'minute', 'minutes');
    var h = Math.floor(m / 60), rest = m % 60;
    return plural(h, 'hour', 'hours') + (rest ? ' ' + rest + ' min' : '');
  }

  function hex4(n) { return '0x' + ('0000' + n.toString(16).toUpperCase()).slice(-4); }

  // What the Status page says about Bluetooth, from /api/status: one of four states (off, waiting, discovery,
  // connected). Pure so the wording is testable.
  function connectionView(bt, device) {
    var name = (device && device.bleName) || 'the device';
    var pairing = bt.pairing || {};
    var timed = pairing.open && pairing.remainingMs !== null && pairing.remainingMs !== undefined;
    var state = bt.state || (bt.enabled === false ? 'off' : timed ? 'discovery' : bt.connected ? 'connected' : 'waiting');
    var note = timed ? ' Discovery is open for ' + fmtDuration(pairing.remainingMs) + '.' : '';
    if (state === 'off') {
      return { tone: 'warn', title: 'Bluetooth is off',
        detail: 'The device is invisible and nothing can connect. Turn Bluetooth on and your paired computers reconnect by themselves.', actions: ['enable'] };
    }
    if (bt.connected && bt.computer) {
      var actions = ['disable'];
      if (timed) actions.unshift('closePairing');
      return { tone: 'ok', title: 'Connected to ' + bt.computer.label,
        detail: 'For ' + fmtSince(bt.computer.connectedForMs) + ' · ' + name + '.' + note, actions: actions };
    }
    if (state === 'discovery' || timed) {
      return { tone: 'open', title: 'Discovery is open',
        detail: 'Closes in ' + fmtDuration(pairing.remainingMs) + '. On the computer, choose “' + name + '”.', actions: ['closePairing'] };
    }
    if (!bt.peerCount) {
      return { tone: 'idle', title: 'No computer paired',
        detail: 'Start Discovery, then choose “' + name + '” in the computer’s Bluetooth settings.', actions: ['pair'] };
    }
    return { tone: 'idle', title: 'Waiting for a computer',
      detail: 'Bluetooth is on. A paired computer reconnects by itself when it is on and nearby.', actions: ['pair', 'disable'] };
  }

  function checkNewToken(next, confirm) {
    if (next.length < 8 || next.length > 40 || /\s/.test(next)) return '8 to 40 characters, no spaces.';
    if (next !== confirm) return 'The two tokens do not match.';
    return '';
  }

  // ---- run for / until a time ----------------------------------------------------------------

  // Minutes from `now` to the next occurrence of "HH:MM" local time (1..1440); null if malformed.
  function minutesUntil(hhmm, now) {
    var m = /^(\d{2}):(\d{2})$/.exec(hhmm || '');
    if (!m || +m[1] > 23 || +m[2] > 59) return null;
    var target = new Date(now.getTime());
    target.setHours(+m[1], +m[2], 0, 0);
    if (target.getTime() <= now.getTime()) target.setDate(target.getDate() + 1);  // calendar day, not 24 h: DST-safe
    var diff = target.getTime() - now.getTime();
    return Math.min(1440, Math.max(1, Math.ceil(diff / 60000)));
  }

  // 0 = no limit, a positive number = minutes, null = the choice is not valid yet.
  function runForMinutes(sel, now) {
    if (sel.choice === 'forever') return 0;
    if (sel.choice === 'until') return minutesUntil(sel.time, now);
    if (sel.choice === 'custom') {
      if (!/^\d+$/.test(String(sel.custom || '').trim())) return null;
      var n = parseInt(sel.custom, 10);
      return n >= 1 && n <= 1440 ? n : null;
    }
    var preset = parseInt(sel.choice, 10);
    return preset >= 1 && preset <= 1440 ? preset : null;
  }

  // The wall-clock moment a run that stops in `ms` ends, e.g. "14:40" or "00:30 tomorrow".
  function stopsAt(ms, now) {
    var end = new Date(now.getTime() + ms);
    var label = pad2(end.getHours()) + ':' + pad2(end.getMinutes());
    var sameDay = end.getFullYear() === now.getFullYear() && end.getMonth() === now.getMonth() && end.getDate() === now.getDate();
    return sameDay ? label : label + ' tomorrow';
  }

  // ---- schedules -----------------------------------------------------------------------------

  function describeDays(days) {
    var set = {};
    days.forEach(function (d) { set[d] = true; });
    var idx = DAYS.filter(function (d) { return set[d]; });
    if (idx.length === 0) return 'No days';
    if (idx.length === 7) return 'Every day';
    var runs = [], start = 0;
    for (var i = 1; i <= idx.length; i++) {
      if (i === idx.length || DAYS.indexOf(idx[i]) !== DAYS.indexOf(idx[i - 1]) + 1) {
        runs.push(idx.slice(start, i));
        start = i;
      }
    }
    return runs.map(function (r) {
      if (r.length >= 3) return DAY_LABELS[r[0]] + '–' + DAY_LABELS[r[r.length - 1]];
      return r.map(function (d) { return DAY_LABELS[d]; }).join(', ');
    }).join(', ');
  }

  function scheduleEnd(start, durationMin) {
    var m = /^(\d{2}):(\d{2})$/.exec(start);
    var total = (+m[1]) * 60 + (+m[2]) + durationMin;
    var day = total >= 1440;
    var t = total % 1440;
    return pad2(Math.floor(t / 60)) + ':' + pad2(t % 60) + (day ? ' next day' : '');
  }

  var ACTION_LABELS = {
    start: 'Start the jiggler', stop: 'Stop the jiggler', pause: 'Pause the jiggler', resume: 'Resume the jiggler',
    bluetooth_on: 'Turn Bluetooth on', bluetooth_off: 'Turn Bluetooth off', discovery: 'Open Discovery'
  };

  function toMinutes(hhmm) {
    var m = /^(\d{2}):(\d{2})$/.exec(hhmm || '');
    if (!m || +m[1] > 23 || +m[2] > 59) return null;
    return (+m[1]) * 60 + (+m[2]);
  }

  // "09:00" for 480 minutes -> "17:00" (wraps past midnight).
  function endFromDuration(start, durationMin) {
    var t = (toMinutes(start) + durationMin) % 1440;
    return pad2(Math.floor(t / 60)) + ':' + pad2(t % 60);
  }

  // The length between two times of day, 1..1440; an end at or before the start means "the next day", and the
  // same time means a full 24 hours. null when either time is not valid.
  function durationFromEnd(start, end) {
    var a = toMinutes(start), b = toMinutes(end);
    if (a === null || b === null) return null;
    return ((b - a + 1440) % 1440) || 1440;
  }

  function describeRepeat(s) {
    if (!s.times) return 'Repeats every week';
    var runs = function (n) { return n + (n === 1 ? ' run' : ' runs'); };
    if (!s.enabled && s.remaining === 0) return 'Finished (' + runs(s.times) + ' done)';
    return s.remaining === s.times ? runs(s.times) : s.remaining + ' of ' + runs(s.times) + ' left';
  }

  function describeJitter(min) { return min ? '± ' + min + ' min' : ''; }

  function scheduleSummary(s) {
    var line = s.kind === 'action'
      ? describeDays(s.days) + ' at ' + s.start + ': ' + (ACTION_LABELS[s.action] || s.action)
      : describeDays(s.days) + ', ' + s.start + ' to ' + scheduleEnd(s.start, s.durationMin);
    if (s.jitterMin) line += ' · ' + describeJitter(s.jitterMin);
    return s.times ? line + ' · ' + describeRepeat(s) : line;
  }

  // One line about the device clock, from the `time` object of /api/status or /api/time.
  function clockLine(time) {
    if (!time || !time.synced) return 'Not set: schedules wait for the time (needs internet, or set it by hand).';
    var day = time.weekday ? time.weekday.charAt(0).toUpperCase() + time.weekday.slice(1) + ' ' : '';
    var source = time.source === 'manual' ? 'set by hand' : 'from NTP';
    return day + time.localTime + ' · ' + time.timezone + ' · ' + source;
  }

  // What the Firmware card says, from GET /api/updates. Pure so the wording is testable.
  function describeUpdate(u) {
    var latest = u.latest && u.latest.version;
    if (u.state === 'checking') return { text: 'Looking for a new version…', tone: 'busy', canInstall: false, working: true };
    if (u.state === 'installing') return { text: 'Downloading ' + (latest || 'the new version') + ': ' + (u.progress || 0) + '%. Do not unplug the device.', tone: 'busy', canInstall: false, working: true };
    if (u.state === 'restarting') return { text: 'Installed. The device is restarting…', tone: 'good', canInstall: false, working: true };
    var checked = u.checkedAgoMs === null || u.checkedAgoMs === undefined ? null : fmtAgo(u.checkedAgoMs);
    var lead;
    if (u.available && u.blocked) lead = 'Version ' + latest + ' is available, but the last attempt to install it did not take effect. You can try again, or install it from a file.';
    else if (u.available) lead = 'Version ' + latest + ' is available.';
    else if (checked !== null && latest) lead = 'You are up to date (' + u.current + '), checked ' + checked + '.';
    else if (checked !== null) lead = 'Checked ' + checked + '.';
    else lead = u.mode === 'ignore' ? 'Updates are ignored: the device does not look for them by itself.' : 'Not checked yet. The device looks by itself every day at ' + (u.checkTime || '03:00') + '.';
    if (u.error) lead += ' ' + tr(u.error);
    return { text: lead, tone: u.error ? 'bad' : u.available ? 'ok' : 'idle', canInstall: !!u.available, working: false };
  }

  // What Status says while the jiggler is stopped, given the `schedule` object of /api/status.
  function stoppedNote(sched) {
    if (sched && sched.active && sched.ownerStopped)
      return 'Not running. A schedule window is open, but the jiggler was stopped on purpose, so it stays stopped until the next window opens. Press Start to run it now.';
    if (sched && sched.active && sched.blocked) return 'Not running. A schedule window is open, but no computer is paired yet.';
    if (sched && sched.active) return 'A schedule window is open: the jiggler is starting.';
    return 'Not running. Press Start to keep the computer awake.';
  }

  // While the device installs new firmware it answers GET /api/updates with two fields only (state, progress), so
  // that building the full answer cannot take the memory the download needs. Keep what we already knew around it.
  function mergeUpdate(prev, next) {
    if (!next) return prev;
    if (!prev || next.current !== undefined) return next;  // a full answer replaces what we had
    var out = {};
    for (var k in prev) if (Object.prototype.hasOwnProperty.call(prev, k)) out[k] = prev[k];
    out.state = next.state;
    out.progress = next.progress || 0;
    return out;
  }

  // The address people see for a repository: "github.com/owner/repo".
  function repoLabel(url) { return String(url || '').replace(/^https?:\/\//, ''); }

  return { DAYS: DAYS, DAY_LABELS: DAY_LABELS, tr: tr, fmtDuration: fmtDuration, fmtAgo: fmtAgo, fmtSince: fmtSince, hex4: hex4,
    connectionView: connectionView, checkNewToken: checkNewToken, minutesUntil: minutesUntil, runForMinutes: runForMinutes,
    stopsAt: stopsAt, describeDays: describeDays, scheduleEnd: scheduleEnd, scheduleSummary: scheduleSummary,
    ACTION_LABELS: ACTION_LABELS, describeJitter: describeJitter, clockLine: clockLine, describeUpdate: describeUpdate, mergeUpdate: mergeUpdate, repoLabel: repoLabel, stoppedNote: stoppedNote,
    endFromDuration: endFromDuration, durationFromEnd: durationFromEnd, describeRepeat: describeRepeat };
})();

if (typeof module !== 'undefined' && module.exports) module.exports = JigLib;

// Shared plumbing: DOM helpers, authenticated fetch, status polling, restart recovery. Views register themselves
// with App.view(name, { load, onStatus, onTick }).
var App = (function () {
  'use strict';
  var KEY = 'jigglerToken';
  var tr = JigLib.tr;
  var token = localStorage.getItem(KEY) || '';
  var views = {}, current = '';
  var status = null, receivedAt = 0;
  var failures = 0, inFlight = false, restarting = false, offlineShown = false;

  function $(id) { return document.getElementById(id); }

  function el(tag, attrs, kids) {
    var e = document.createElement(tag);
    Object.keys(attrs || {}).forEach(function (k) {
      if (k === 'class') e.className = attrs[k];
      else if (k === 'text') e.textContent = attrs[k];
      else e.setAttribute(k, attrs[k]);
    });
    (kids || []).forEach(function (c) { e.appendChild(c); });
    return e;
  }

  var uid = 0;
  function labeled(text, input, errKey) {
    var id = 'f' + (++uid);
    input.id = id;
    var box = el('div', { class: 'field' }, [el('label', { 'for': id, text: text }), input]);
    var err = el('div', { class: 'err' });
    err.setAttribute('data-err', errKey);
    box.appendChild(err);
    return box;
  }
  function clearErrors(root) { root.querySelectorAll('[data-err]').forEach(function (e) { e.textContent = ''; }); }
  function showError(root, field, message) {
    var e = root.querySelector('[data-err="' + field + '"]');
    if (e) { e.textContent = tr(message); return true; }
    return false;
  }
  function say(text, kind, id) { var m = $(id || 'msg'); m.textContent = text; m.className = 'msg ' + (kind || ''); }

  var bannerTimer = 0;
  function banner(text, kind, autoHideMs) {
    var b = $('banner');
    clearTimeout(bannerTimer);
    b.textContent = text || '';
    b.className = 'banner ' + (kind || '');
    b.hidden = !text;
    if (text && autoHideMs) bannerTimer = setTimeout(function () { banner(''); }, autoHideMs);
  }

  function setToken(t) { token = t; if (t) localStorage.setItem(KEY, t); else localStorage.removeItem(KEY); }
  function getToken() { return token; }

  function showLogin(error) {
    $('loginErr').textContent = error || '';
    $('login').hidden = false;
    $('tokenInput').value = '';
    $('tokenInput').focus();
  }

  // body: object (sent as JSON) or string (sent as is). Resolves { status, data }; rejects when unreachable.
  function call(method, path, body) {
    var opts = { method: method, headers: { 'Authorization': 'Bearer ' + token } };
    if (body !== undefined) {
      opts.headers['Content-Type'] = 'application/json';
      opts.body = typeof body === 'string' ? body : JSON.stringify(body);
    }
    return fetch(path, opts).then(function (r) {
      if (r.status === 401) { setToken(''); showLogin('Invalid token.'); throw new Error('unauthorized'); }
      return r.json().catch(function () { return {}; }).then(function (data) {
        failures = 0;
        document.body.classList.remove('offline');
        if (offlineShown && !restarting) { banner(''); offlineShown = false; }
        return { status: r.status, data: data };
      });
    }, function (e) {
      failures++;
      if (!restarting && failures >= 2) {
        document.body.classList.add('offline');
        banner('Device not reachable. Retrying.', 'bad');
        offlineShown = true;
      }
      throw e;
    });
  }

  // Two-step button: the first click arms it for 4 s ("Conferma: …"), the second runs the action.
  function confirmInline(btn, armedText, action) {
    var original = btn.textContent, armed = false, timer = 0;
    function reset() { armed = false; clearTimeout(timer); btn.textContent = original; btn.classList.remove('confirm'); }
    btn.addEventListener('click', function () {
      if (!armed) {
        armed = true;
        btn.textContent = armedText;
        btn.classList.add('confirm');
        timer = setTimeout(reset, 4000);
        return;
      }
      reset();
      action();
    });
    btn.isArmed = function () { return armed; };
  }

  // ---- views and routing ------------------------------------------------------------------
  function view(name, impl) { views[name] = impl; }
  function reloadCurrent() { if (views[current] && views[current].load && token) views[current].load(); }

  function route() {
    var name = (location.hash || '#status').slice(1);
    if (name === 'movement') name = 'device';  // the section was renamed
    if (!views[name]) name = 'status';
    var changed = name !== current;
    current = name;
    document.querySelectorAll('.view').forEach(function (v) { v.hidden = v.id !== 'view-' + name; });
    document.querySelectorAll('#nav a').forEach(function (a) {
      if (a.getAttribute('data-view') === name) a.setAttribute('aria-current', 'page');
      else a.removeAttribute('aria-current');
    });
    if (changed) {
      var h = document.querySelector('#view-' + name + ' h1');
      if (h && document.documentElement.getAttribute('data-ready')) { h.tabIndex = -1; h.focus({ preventScroll: true }); }
      window.scrollTo(0, 0);
    }
    reloadCurrent();
  }

  // ---- status polling ---------------------------------------------------------------------
  // While the device installs new firmware it refuses everything but the progress (503 "installing"), because
  // building an answer can take the memory the download needs. The dashboard then stops asking for the status and
  // looks at the progress every few seconds instead, which costs the device almost nothing.
  var installing = false, lastProbeAt = 0;
  var kInstallProbeMs = 5000;

  function enterInstalling() {
    if (installing) return;
    installing = true;
    lastProbeAt = 0;
    banner('Installing new firmware. The dashboard waits: the device restarts when it is done.', '');
  }

  function probeInstall() {
    if (performance.now() - lastProbeAt < kInstallProbeMs) return;
    lastProbeAt = performance.now();
    inFlight = true;
    call('GET', '/api/updates').then(function (res) {
      if (res.status === 503) return;
      if (res.data && res.data.state === 'restarting') { installing = false; waitForDevice(); return; }
      if (res.status === 200 && res.data && res.data.state !== 'installing') {
        installing = false;   // it ended without a restart: a failure the device survived
        banner('');
        reloadCurrent();
      }
    }).catch(function () {}).then(function () { inFlight = false; });
  }

  function poll() {
    if (!token || inFlight || restarting || document.hidden) return;
    if (installing) { probeInstall(); return; }
    inFlight = true;
    call('GET', '/api/status').then(function (res) {
      if (res.status === 503 && res.data && res.data.error === 'installing') { enterInstalling(); return; }
      status = res.data;
      receivedAt = performance.now();
      Object.keys(views).forEach(function (n) { if (views[n].onStatus) views[n].onStatus(status); });
    }).catch(function () {}).then(function () { inFlight = false; });
  }

  function tick() {
    if (!status) return;
    Object.keys(views).forEach(function (n) { if (views[n].onTick) views[n].onTick(status, performance.now() - receivedAt); });
  }

  // ---- restart ----------------------------------------------------------------------------
  function waitForDevice() {
    restarting = true;
    banner('Restarting… the page reconnects by itself.', '');
    var started = performance.now();
    function probe() {
      fetch('/api/status', { headers: { 'Authorization': 'Bearer ' + token } }).then(function (r) {
        if (r.ok) {
          restarting = false;
          installing = false;
          failures = 0;
          document.body.classList.remove('offline');
          banner('Device is back online.', 'good', 4000);
          reloadCurrent();
          poll();
        } else { again(); }
      }, again);
    }
    function again() {
      if (performance.now() - started > 60000) {
        restarting = false;
        banner('The device is not responding. Check its power and your network, then reload the page.', 'bad');
        return;
      }
      setTimeout(probe, 1500);
    }
    setTimeout(probe, 3000);
  }

  function restartDevice() {
    return call('POST', '/api/restart').then(function (res) {
      if (res.status === 200 || res.status === 202) waitForDevice();
    }).catch(function () {});
  }

  return {
    $: $, el: el, labeled: labeled, clearErrors: clearErrors, showError: showError, say: say, banner: banner,
    call: call, setToken: setToken, getToken: getToken, showLogin: showLogin, confirmInline: confirmInline,
    view: view, route: route, poll: poll, tick: tick, installing: function () { return installing; }, restartDevice: restartDevice, waitForDevice: waitForDevice, reloadCurrent: reloadCurrent,
    status: function () { return status; }
  };
})();

// Status: the connection hero (which computer, since when, disconnect/pair) and the run controls.
(function () {
  'use strict';
  var $ = App.$, el = App.el, say = App.say, tr = JigLib.tr;
  var fmtDuration = JigLib.fmtDuration, fmtAgo = JigLib.fmtAgo;
  var CHOICE_KEY = 'jigglerRunChoice';

  function fail(r) { return [tr(r.data && r.data.message) || 'That did not work.', 'bad']; }
  var ACTIONS = {
    disable: { label: 'Turn Bluetooth off', primary: false, run: function () {
      return App.call('POST', '/api/bluetooth/disable').then(function (r) {
        return r.status === 200 ? ['Bluetooth is off. The device is invisible until you turn it on.', 'good'] : fail(r);
      }); } },
    enable: { label: 'Turn Bluetooth on', primary: true, run: function () {
      return App.call('POST', '/api/bluetooth/enable').then(function (r) {
        return r.status === 200 ? ['Bluetooth is on: paired computers reconnect by themselves.', 'good'] : fail(r);
      }); } },
    pair: { label: 'Start Discovery', primary: true, run: function () {
      return App.call('POST', '/api/bluetooth/pairing').then(function (r) {
        return r.status === 200 ? ['Discovery is open.', 'good'] : fail(r);
      }); } },
    closePairing: { label: 'Stop Discovery', primary: false, run: function () {
      return App.call('DELETE', '/api/bluetooth/pairing').then(function (r) {
        return r.status === 200 ? ['Discovery stopped.', 'good'] : fail(r);
      }); } }
  };

  var shownActions = '';

  function adjusted(status, elapsed) {
    var bt = JSON.parse(JSON.stringify(status.bluetooth || { pairing: {}, peerCount: 0 }));
    if (bt.pairing && bt.pairing.remainingMs != null) bt.pairing.remainingMs = Math.max(0, bt.pairing.remainingMs - elapsed);
    if (bt.computer) bt.computer.connectedForMs += elapsed;
    return bt;
  }

  function renderHero(status, elapsed) {
    var v = JigLib.connectionView(adjusted(status, elapsed), status.device);
    $('hero').setAttribute('data-tone', v.tone);
    $('heroTitle').textContent = v.title;
    $('heroDetail').textContent = v.detail;
    var key = v.actions.join(',');
    if (key === shownActions) return;
    shownActions = key;
    var box = $('heroActions');
    box.textContent = '';
    v.actions.forEach(function (name) {
      var a = ACTIONS[name];
      var b = el('button', { text: a.label, class: a.primary ? 'primary' : '' });
      b.onclick = function () {
        b.disabled = true;
        say('', '', 'heroMsg');
        a.run().then(function (r) { say(r[0], r[1], 'heroMsg'); App.poll(); }).catch(function () {}).then(function () { b.disabled = false; });
      };
      box.appendChild(b);
    });
    $('heroNote').textContent = key.indexOf('disconnect') >= 0
      ? 'Disconnect does not power the device off: it drops the link and keeps the device visible but not connectable until you press Reconnect (a restart also brings it back). Pressing Disconnect in the computer’s own Bluetooth menu does the same.' : '';
  }

  function renderMotion(s, elapsed) {
    var running = s.state === 'running', paused = s.state === 'paused';
    $('state').textContent = running ? 'Running' : paused ? 'Paused' : 'Stopped';
    var next = $('next');
    if (paused) {
      var back = s.resumesInMs != null ? Math.max(0, s.resumesInMs - elapsed) : null;
      var text = back != null ? 'Resumes in ' + fmtDuration(back) + ' (at ' + JigLib.stopsAt(back, new Date()) + ')' : 'Paused until you press Resume';
      if (s.stopsInMs != null) {
        var left0 = Math.max(0, s.stopsInMs - elapsed);
        text += ' · stops at ' + JigLib.stopsAt(left0, new Date());
      }
      next.textContent = text + '.';
    } else if (!running) next.textContent = JigLib.stoppedNote(s.schedule);
    else {
      var parts = [];
      if (!s.mouseConnected && s.msToNextMove === 0) parts.push('Waiting for a computer to connect.');
      else parts.push('Next movement in ' + fmtDuration(Math.max(0, s.msToNextMove - elapsed)));
      if (s.stopsInMs != null) {
        var left = Math.max(0, s.stopsInMs - elapsed);
        parts.push('stops in ' + fmtDuration(left) + ' (at ' + JigLib.stopsAt(left, new Date()) + ')');
      }
      next.textContent = parts.join(' · ');
    }
  }

  function renderFacts(s) {
    $('count').textContent = s.moveCount;
    if (s.lastMoveAt !== null) $('last').textContent = new Date(s.lastMoveAt * 1000).toLocaleTimeString('en-GB');
    else if (s.lastMoveAgoMs !== null) $('last').textContent = fmtAgo(s.lastMoveAgoMs);
    else $('last').textContent = 'never';
    $('wifi').textContent = s.wifiConnected ? 'Connected' : 'Not connected';
    var sc = s.schedule;
    $('clock').textContent = s.time ? JigLib.clockLine(s.time) + (sc && sc.active ? ' · schedule open' : '') : '—';
    var un = $('updNote');
    var upd = s.update;
    un.hidden = !(upd && upd.available && upd.mode !== 'ignore');
    if (!un.hidden) { un.textContent = ''; un.appendChild(document.createTextNode('Version ' + upd.version + ' is available. ')); var a = document.createElement('a'); a.href = '#system'; a.textContent = 'Open System to install it.'; un.appendChild(a); }
    var note = $('schedNote');
    note.hidden = !(sc && sc.blocked);
    note.textContent = sc && sc.blocked ? 'A schedule window is open, but no computer is paired yet, so the jiggler cannot start.' : '';
    var running = s.state === 'running', paused = s.state === 'paused', stopped = !running && !paused;
    $('bToggle').textContent = stopped ? 'Start' : 'Stop';
    $('bToggle').className = stopped ? 'primary' : '';
    $('bPause').hidden = !running;
    $('bResume').hidden = !paused;
    $('pauseFor').hidden = !running;
    $('runFor').hidden = !stopped;
    $('runErr').textContent = running ? '' : $('runErr').textContent;
    $('bMove').disabled = !s.mouseConnected;
  }

  // ---- first-time setup: shown while no computer is paired ----
  function renderSetup(status, elapsed) {
    var bt = status.bluetooth;
    var needed = !!bt && !bt.peerCount;
    $('setup').hidden = !needed;
    $('hero').hidden = needed;
    $('movementBlock').hidden = needed;
    if (!needed) return;
    var p = bt.pairing || {};
    var open = !!p.open && p.remainingMs != null;
    $('setupName').textContent = '“' + ((status.device && status.device.bleName) || 'the device') + '”';
    $('stepPair').className = 'step' + (open ? ' done' : ' active');
    $('stepPair').querySelector('.num').textContent = open ? '✓' : '2';
    $('stepChoose').className = 'step' + (open ? ' active' : '');
    $('setupWait').hidden = !open;
    $('setupOpen').hidden = open;
    $('setupStop').hidden = !open;
    $('setupPairText').textContent = open
      ? 'Discovery is open: closes in ' + fmtDuration(Math.max(0, p.remainingMs - elapsed)) + '. It closes by itself as soon as a computer pairs.'
      : 'Discovery is closed, so nobody can pair by accident. Open it for a few minutes. You can also hold the button on the board for 5 to 10 seconds, then let go.';
  }
  $('setupOpen').onclick = function () {
    $('setupOpen').disabled = true;
    ACTIONS.pair.run().then(function (r) { say(r[1] === 'bad' ? r[0] : '', r[1], 'setupMsg'); App.poll(); }).catch(function () {}).then(function () { $('setupOpen').disabled = false; });
  };
  $('setupStop').onclick = function () {
    ACTIONS.closePairing.run().then(function (r) { say(r[1] === 'bad' ? r[0] : '', r[1], 'setupMsg'); App.poll(); }).catch(function () {});
  };

  App.view('status', {
    onStatus: function (s) { renderSetup(s, 0); renderHero(s, 0); renderMotion(s, 0); renderFacts(s); },
    onTick: function (s, elapsed) { renderSetup(s, elapsed); renderHero(s, elapsed); renderMotion(s, elapsed); }
  });

  // ---- run for ----
  function readChoice() {
    return { choice: $('runChoice').value, time: $('runUntil').value, custom: $('runCustom').value };
  }
  function showChoiceFields() {
    var c = $('runChoice').value;
    $('runUntilBox').hidden = c !== 'until';
    $('runCustomBox').hidden = c !== 'custom';
    $('runErr').textContent = '';
  }
  $('runChoice').addEventListener('change', function () {
    showChoiceFields();
    try { localStorage.setItem(CHOICE_KEY, JSON.stringify(readChoice())); } catch (e) {}
  });
  ['runUntil', 'runCustom'].forEach(function (id) {
    $(id).addEventListener('input', function () {
      $('runErr').textContent = '';
      try { localStorage.setItem(CHOICE_KEY, JSON.stringify(readChoice())); } catch (e) {}
    });
  });
  (function restoreChoice() {
    try {
      var saved = JSON.parse(localStorage.getItem(CHOICE_KEY) || 'null');
      if (saved && $('runChoice').querySelector('option[value="' + saved.choice + '"]')) {
        $('runChoice').value = saved.choice;
        $('runUntil').value = saved.time || '';
        $('runCustom').value = saved.custom || '';
      }
    } catch (e) {}
    showChoiceFields();
  })();

  function control(method, path, body, okText) {
    return App.call(method, path, body).then(function (res) {
      if (res.status >= 400) say(res.data.error === 'mouse_not_connected' ? 'No computer connected: pair one from the Computers section.' : tr(res.data.message) || 'That did not work.', 'bad');
      else say(okText, 'good');
      App.poll();
    }).catch(function () {});
  }

  $('bPause').onclick = function () {
    var minutes = Number($('pauseChoice').value);
    try { localStorage.setItem('jigglerPauseChoice', String(minutes)); } catch (e) {}
    if (minutes > 0) control('POST', '/api/pause', { minutes: minutes }, 'Paused: it resumes by itself in ' + JigLib.fmtSince(minutes * 60000) + '.');
    else control('POST', '/api/pause', undefined, 'Paused until you press Resume.');
  };
  $('bResume').onclick = function () { control('POST', '/api/resume', undefined, 'Resumed.'); };
  (function restorePauseChoice() {
    try {
      var saved = localStorage.getItem('jigglerPauseChoice');
      if (saved !== null && $('pauseChoice').querySelector('option[value="' + saved + '"]')) $('pauseChoice').value = saved;
    } catch (e) {}
  })();

  $('bToggle').onclick = function () {
    var s = App.status();
    var active = s && (s.state === 'running' || s.state === 'paused');
    if (active) { control('POST', '/api/stop', undefined, 'Stopped.'); return; }
    var minutes = JigLib.runForMinutes(readChoice(), new Date());
    if (minutes === null) {
      $('runErr').textContent = $('runChoice').value === 'until' ? 'Pick the time it should stop.' : 'Enter a whole number of minutes from 1 to 1440.';
      return;
    }
    $('runErr').textContent = '';
    if (minutes === 0) control('POST', '/api/start', undefined, 'Started.');
    else control('POST', '/api/start', { minutes: minutes }, 'Started: it stops by itself in ' + JigLib.fmtSince(minutes * 60000) + '.');
  };
  $('bMove').onclick = function () { control('POST', '/api/move', undefined, 'Moving now.'); setTimeout(App.poll, 1500); };
})();

// Computers: the Bluetooth state, Discovery (the pairing window) and the list of paired computers (rename, forget).
(function () {
  'use strict';
  var $ = App.$, el = App.el, say = App.say, tr = JigLib.tr;
  var peers = [], shown = '', editing = null, lastFetch = 0, busy = false;
  var settingsShown = '', settingsDirty = false;

  function reply(res, okText, id) {
    if (res.status === 200) { say(okText, 'good', id); return true; }
    say(tr(res.data && res.data.message) || 'That did not work.', 'bad', id);
    return false;
  }

  var STATE_TEXT = {
    off: 'Off: the radio is silent. Nothing can see or reach the device.',
    waiting: 'Waiting: on. Only computers that are already paired can find the device and connect.',
    discovery: 'Discovery: open, so a new computer can pair.',
    connected: 'Connected to a computer.'
  };

  function renderPairing(status, elapsed) {
    var bt = status && status.bluetooth;
    if (!bt) return;
    var p = bt.pairing || {};
    var timed = p.open && p.remainingMs != null;
    var off = bt.state === 'off';
    $('btInfo').textContent = STATE_TEXT[bt.state] || '';
    $('btToggle').textContent = off ? 'Turn Bluetooth on' : 'Turn Bluetooth off';
    $('btToggle').className = off ? 'primary' : '';
    $('btToggle').disabled = busy;
    $('pairInfo').textContent = timed
      ? 'Discovery is open: closes in ' + JigLib.fmtDuration(Math.max(0, p.remainingMs - elapsed)) + '. It also closes as soon as a computer pairs.'
      : 'Discovery is closed: no new computer can pair.';
    $('pairOpen').disabled = busy || (p.open && !timed);
    $('pairOpen').textContent = timed ? 'Restart Discovery' : 'Start Discovery';
    $('pairClose').disabled = busy || !timed;
    var key = bt.discoverySeconds + '|' + bt.offWhenComputerDisconnects;
    if (key !== settingsShown && !settingsDirty) {
      settingsShown = key;
      $('discSeconds').value = bt.discoverySeconds;
      $('offOnDisc').checked = !!bt.offWhenComputerDisconnects;
    }
  }

  function peerRow(p) {
    var li = el('li');
    if (editing === p.id) {
      var input = el('input', { autocomplete: 'off', 'aria-label': 'Computer name', maxlength: '32' });
      input.value = p.label;
      var save = el('button', { class: 'primary', text: 'Save' });
      var cancel = el('button', { text: 'Cancel' });
      var err = el('div', { class: 'err' });
      function done() { editing = null; shown = ''; draw(); }
      function commit() {
        var name = input.value.trim();
        if (!name) { err.textContent = 'Enter a name.'; return; }
        App.call('PUT', '/api/bluetooth/peers/' + p.id, { label: name }).then(function (res) {
          if (res.status === 200) { done(); load(); } else err.textContent = tr(res.data && res.data.message);
        }).catch(function () {});
      }
      save.onclick = commit;
      cancel.onclick = done;
      input.addEventListener('keydown', function (e) { if (e.key === 'Enter') commit(); if (e.key === 'Escape') done(); });
      li.appendChild(el('div', { class: 'peer-edit' }, [input, save, cancel]));
      li.appendChild(err);
      setTimeout(function () { input.focus(); input.select(); }, 0);
      return li;
    }
    var meta = el('div', { class: 'peer-meta' });
    if (p.connected) meta.appendChild(el('span', { class: 'peer-live', text: 'Connected now' }));
    else meta.appendChild(document.createTextNode('Paired'));
    meta.appendChild(document.createTextNode(' · ' + p.address));
    var rename = el('button', { class: 'link', text: 'Rename' });
    rename.onclick = function () { editing = p.id; shown = ''; draw(); };
    var forget = el('button', { class: 'link danger', text: 'Forget' });
    App.confirmInline(forget, 'Confirm: forget', function () {
      App.call('DELETE', '/api/bluetooth/peers/' + p.id).then(function (res) {
        reply(res, '“' + p.label + '” forgotten. To use it again, pair it from scratch (and remove the device in that computer’s Bluetooth settings).', 'peersMsg');
        load(); App.poll();
      }).catch(function () {});
    });
    li.appendChild(el('div', { class: 'peer-top' }, [
      el('div', {}, [el('div', { class: 'peer-name', text: p.label }), meta]),
      el('div', { class: 'peer-actions' }, [rename, forget])
    ]));
    return li;
  }

  function draw() {
    var key = JSON.stringify(peers) + '|' + editing;
    if (key === shown) return;
    shown = key;
    var list = $('peers');
    list.textContent = '';
    peers.forEach(function (p) { list.appendChild(peerRow(p)); });
    $('peersEmpty').hidden = peers.length > 0;
    $('forgetAll').hidden = peers.length === 0;
  }

  function armed() {
    return !!document.querySelector('#peers .confirm') || $('forgetAll').classList.contains('confirm');
  }

  function load() {
    lastFetch = performance.now();
    App.call('GET', '/api/bluetooth').then(function (res) {
      if (res.status !== 200) return;
      peers = res.data.peers;
      if (editing === null && !armed()) draw();
    }).catch(function () {});
  }

  App.view('computers', {
    load: load,
    onStatus: function (s) {
      renderPairing(s, 0);
      if (!$('view-computers').hidden && performance.now() - lastFetch > 2000) load();
    },
    onTick: function (s, elapsed) { renderPairing(s, elapsed); }
  });

  function run(method, path, okText, id) {
    busy = true; renderPairing(App.status(), 0);
    return App.call(method, path).then(function (res) { reply(res, okText, id); }).catch(function () {}).then(function () { busy = false; App.poll(); });
  }
  $('pairOpen').onclick = function () { run('POST', '/api/bluetooth/pairing', 'Discovery is open. On the computer, choose the device in the Bluetooth list.', 'pairMsg'); };
  $('pairClose').onclick = function () { run('DELETE', '/api/bluetooth/pairing', 'Discovery stopped.', 'pairMsg'); };
  $('btToggle').onclick = function () {
    var off = App.status() && App.status().bluetooth && App.status().bluetooth.state === 'off';
    if (off) run('POST', '/api/bluetooth/enable', 'Bluetooth is on: paired computers reconnect by themselves.', 'btMsg');
    else run('POST', '/api/bluetooth/disable', 'Bluetooth is off. The device is invisible until you turn it on.', 'btMsg');
  };
  ['discSeconds', 'offOnDisc'].forEach(function (id) { $(id).addEventListener('input', function () { settingsDirty = true; }); $(id).addEventListener('change', function () { settingsDirty = true; }); });
  $('discSave').onclick = function () {
    var root = $('view-computers');
    root.querySelector('[data-err="discoverySeconds"]').textContent = '';
    say('', '', 'discMsg');
    var raw = $('discSeconds').value.trim();
    if (!/^\d+$/.test(raw)) { root.querySelector('[data-err="discoverySeconds"]').textContent = 'Enter a whole number of seconds from 30 to 600.'; return; }
    App.call('PUT', '/api/bluetooth/settings', { discoverySeconds: Number(raw), offWhenComputerDisconnects: $('offOnDisc').checked }).then(function (res) {
      if (res.status === 200) { settingsDirty = false; settingsShown = ''; say('Saved.', 'good', 'discMsg'); App.poll(); return; }
      var d = res.data;
      if (!d.field || !App.showError(root, d.field, d.message)) say(tr(d.message) || 'Could not save.', 'bad', 'discMsg');
    }).catch(function () {});
  };
  App.confirmInline($('forgetAll'), 'Confirm: forget all', function () {
    App.call('DELETE', '/api/bluetooth/peers').then(function (res) {
      reply(res, 'All computers forgotten. Discovery stays closed: start it to add one.', 'peersMsg');
      load(); App.poll();
    }).catch(function () {});
  });
})();

// Device: how the movement behaves, and how the device appears over Bluetooth.
(function () {
  'use strict';
  var $ = App.$, el = App.el, say = App.say, tr = JigLib.tr, hex4 = JigLib.hex4;
  var labeled = App.labeled, clearErrors = App.clearErrors, showError = App.showError;
  var FIELDS = [
    { id: 'minIntervalSec', scale: 1 }, { id: 'maxIntervalSec', scale: 1 }, { id: 'amplitudePx', scale: 1 },
    { id: 'clickProbability', scale: 100 }, { id: 'scrollProbability', scale: 100 }
  ];
  var dirty = {}, config = null;

  function fieldError(id, text) { var e = $('e_' + id); if (e) e.textContent = text; }

  function populate(s) {
    config = s.config;
    FIELDS.forEach(function (f) {
      if (dirty[f.id] || document.activeElement === $(f.id)) return;
      $(f.id).value = String(Math.round(s.config[f.id] * f.scale));
    });
  }
  FIELDS.forEach(function (f) { $(f.id).addEventListener('input', function () { dirty[f.id] = true; }); });

  $('cfg').addEventListener('submit', function (ev) {
    ev.preventDefault();
    FIELDS.forEach(function (f) { fieldError(f.id, ''); $(f.id).removeAttribute('aria-invalid'); });
    if (!config) return;
    var body = {}, invalid = false;
    FIELDS.forEach(function (f) {
      var raw = $(f.id).value.trim().replace(',', '.');
      if (raw === '') { fieldError(f.id, 'This field is required.'); invalid = true; return; }
      var n = Number(raw);
      if (!isFinite(n)) { fieldError(f.id, 'Enter a number.'); invalid = true; return; }
      if (n !== Math.round(config[f.id] * f.scale)) body[f.id] = n / f.scale;
    });
    if (invalid) return;
    say('', '', 'cfgMsg');
    if (Object.keys(body).length === 0) { say('Nothing to save.', '', 'cfgMsg'); return; }
    App.call('PUT', '/api/config', body).then(function (res) {
      if (res.status === 200) { dirty = {}; say('Configuration saved.', 'good', 'cfgMsg'); App.poll(); return; }
      var d = res.data;
      if (d.field && $('e_' + d.field)) { fieldError(d.field, tr(d.message)); $(d.field).setAttribute('aria-invalid', 'true'); }
      else say('Could not save.', 'bad', 'cfgMsg');
    }).catch(function () {});
  });

  // ---- Appearance (how the device introduces itself over Bluetooth) ----
  var appearance = null, loadedKey = '';

  function profileInfo(id) {
    var list = appearance ? appearance.profiles : [];
    for (var i = 0; i < list.length; i++) if (list[i].id === id) return list[i];
    var c = appearance.custom;
    return { id: 'custom', name: c.name, manufacturer: c.manufacturer, vid: c.vid, pid: c.pid, oui: null };
  }

  function showPlaceholders() {
    var p = profileInfo($('apModel').value);
    $('apName').placeholder = p.name;
    $('apManufacturer').placeholder = p.manufacturer;
    $('apVid').placeholder = hex4(p.vid);
    $('apPid').placeholder = hex4(p.pid);
    $('apMac').placeholder = p.oui ? p.oui + ':xx:xx:xx (the rest from the chip)' : 'the chip’s own address';
  }

  function parseId(text) {
    var t = text.trim();
    if (/^0x[0-9a-f]{1,4}$/i.test(t)) return parseInt(t.slice(2), 16);
    if (/^\d{1,5}$/.test(t) && Number(t) <= 65535) return Number(t);
    return null;
  }

  // The request body for what the form shows now; { error: [field, message] } when a field cannot be read.
  function readAppearance() {
    var body = { profile: $('apModel').value };
    var name = $('apName').value.trim(), man = $('apManufacturer').value.trim(), mac = $('apMac').value.trim();
    if (name) body.name = name;
    if (man) body.manufacturer = man;
    if (mac) body.mac = mac;
    var ids = [['vid', 'apVid'], ['pid', 'apPid']];
    for (var i = 0; i < ids.length; i++) {
      var raw = $(ids[i][1]).value.trim();
      if (!raw) continue;
      var n = parseId(raw);
      if (n === null) return { error: [ids[i][0], 'must be an integer from 0 to 65535'] };
      body[ids[i][0]] = n;
    }
    return { body: body };
  }

  function renderAppearance() {
    var sel = $('apModel');
    sel.textContent = '';
    sel.appendChild(el('option', { value: 'custom', text: 'Custom' }));
    appearance.profiles.forEach(function (p) { sel.appendChild(el('option', { value: p.id, text: p.label })); });
    sel.value = appearance.profile;
    $('apName').value = appearance.name || '';
    $('apManufacturer').value = appearance.manufacturer || '';
    $('apVid').value = appearance.vid !== undefined ? hex4(appearance.vid) : '';
    $('apPid').value = appearance.pid !== undefined ? hex4(appearance.pid) : '';
    $('apMac').value = appearance.mac || '';
    showPlaceholders();
    loadedKey = JSON.stringify(readAppearance().body);
    $('apNow').textContent = 'Currently shown as: ' + appearance.shownAs + '.';
  }

  function loadAppearance() {
    App.call('GET', '/api/appearance').then(function (res) {
      if (res.status !== 200) return;
      appearance = res.data;
      renderAppearance();
    }).catch(function () {});
  }
  $('apModel').addEventListener('change', showPlaceholders);

  App.confirmInline($('apApply'), 'Confirm: restart and pair again', function () {
    var root = $('appearanceBox');
    clearErrors(root);
    say('', '', 'apMsg');
    var read = readAppearance();
    if (read.error) { showError(root, read.error[0], read.error[1]); return; }
    if (JSON.stringify(read.body) === loadedKey) { say('Nothing to change.', '', 'apMsg'); return; }
    App.call('PUT', '/api/appearance', read.body).then(function (res) {
      if (res.status === 200) { say('Saved. Restarting…', 'good', 'apMsg'); return App.restartDevice(); }
      if (!res.data.field || !showError(root, res.data.field, res.data.message)) say(tr(res.data.message) || 'Could not save.', 'bad', 'apMsg');
    }).catch(function () {});
  });

  App.view('device', {
    load: function () { if (App.status()) populate(App.status()); loadAppearance(); },
    onStatus: function (s) { populate(s); }
  });
})();

// Schedule: weekly windows that start and stop the jiggler, and actions done at one time of day.
(function () {
  'use strict';
  var $ = App.$, el = App.el, say = App.say, tr = JigLib.tr;
  var labeled = App.labeled, clearErrors = App.clearErrors, showError = App.showError;

  var sched = { schedules: [] };
  var MAX_SCHEDULES = 8;
  var ACTIONS = ['start', 'stop', 'pause', 'resume', 'bluetooth_on', 'bluetooth_off', 'discovery'];

  function readCard(card) {
    var days = [];
    card.querySelectorAll('.days button').forEach(function (b) { if (b.getAttribute('aria-pressed') === 'true') days.push(b.getAttribute('data-day')); });
    var kind = card.querySelector('[data-k=kind]').value;
    var start = card.querySelector('[data-k=start]').value;
    var end = card.querySelector('[data-k=end]').value;
    var mode = card.querySelector('[data-k=repeat]').value;
    var timesInput = card.querySelector('[data-k=times]');
    var times = mode === 'times' ? Number(timesInput.value) : null;
    var remaining = timesInput.getAttribute('data-remaining');
    var jitter = card.querySelector('[data-k=jitter]').value.trim();
    var out = {
      id: card.querySelector('[data-k=id]').value.trim(),
      enabled: card.querySelector('[data-k=enabled]').checked,
      kind: kind,
      days: days,
      start: start,
      jitterMin: /^\d+$/.test(jitter) ? Number(jitter) : 0,
      times: times,
      // progress is kept while the count is unchanged; a new count starts a fresh run
      remaining: times && remaining !== null && Number(remaining) <= times && Number(timesInput.getAttribute('data-times')) === times ? Number(remaining) : times
    };
    if (kind === 'action') out.action = card.querySelector('[data-k=action]').value;
    else out.durationMin = JigLib.durationFromEnd(start, end);
    return out;
  }

  function readSchedules() {
    var out = [];
    $('schedList').querySelectorAll('.sched').forEach(function (card) { out.push(readCard(card)); });
    return out;
  }

  function refreshSummary(card) {
    var s = readCard(card);
    var isAction = s.kind === 'action';
    var sum = card.querySelector('.sched-sum');
    var ok = /^\d{2}:\d{2}$/.test(s.start) && (isAction || s.durationMin !== null);
    sum.textContent = ok ? JigLib.scheduleSummary(s) : JigLib.describeDays(s.days) + ', set ' + (isAction ? 'a time' : 'a start and an end time');
    sum.className = 'sched-sum' + (s.enabled ? '' : ' off');
    card.querySelector('[data-k=times]').closest('.field').hidden = card.querySelector('[data-k=repeat]').value !== 'times';
    card.querySelector('[data-k=action]').closest('.field').hidden = !isAction;
    card.querySelector('[data-k=end]').closest('.field').hidden = isAction;
    card.querySelector('.when-hint').hidden = isAction;
    card.querySelector('[data-k=start]').closest('.field').querySelector('label').textContent = isAction ? 'At' : 'Starts at';
  }

  function renderSchedules() {
    var box = $('schedList');
    box.textContent = '';
    sched.schedules.forEach(function (sc, i) {
      var card = el('div', { class: 'sched' });
      var sum = el('span', { class: 'sched-sum' });
      var en = el('input', { type: 'checkbox' });
      en.setAttribute('data-k', 'enabled');
      en.checked = sc.enabled;
      en.addEventListener('change', function () { refreshSummary(card); });
      card.appendChild(el('div', { class: 'sched-head' }, [sum, el('label', { class: 'inline' }, [en, el('span', { text: 'On' })])]));

      var id = el('input', { autocomplete: 'off', placeholder: 'a-z 0-9 _ -' });
      id.setAttribute('data-k', 'id');
      id.value = sc.id;
      var kind = el('select');
      kind.setAttribute('data-k', 'kind');
      kind.appendChild(el('option', { value: 'window', text: 'Window' }));
      kind.appendChild(el('option', { value: 'action', text: 'Action' }));
      kind.value = sc.kind === 'action' ? 'action' : 'window';
      kind.addEventListener('change', function () { refreshSummary(card); });
      card.appendChild(el('div', { class: 'row3' }, [labeled('Name', id, 'schedules[' + i + '].id'), labeled('Type', kind, 'schedules[' + i + '].kind')]));

      var action = el('select');
      action.setAttribute('data-k', 'action');
      ACTIONS.forEach(function (a) { action.appendChild(el('option', { value: a, text: JigLib.ACTION_LABELS[a] })); });
      action.value = sc.action || 'start';
      action.addEventListener('change', function () { refreshSummary(card); });
      card.appendChild(labeled('Do', action, 'schedules[' + i + '].action'));

      var days = el('div', { class: 'days', role: 'group', 'aria-label': 'Days' });
      JigLib.DAYS.forEach(function (d) {
        var b = el('button', { type: 'button', text: JigLib.DAY_LABELS[d] });
        b.setAttribute('data-day', d);
        b.setAttribute('aria-pressed', sc.days.indexOf(d) >= 0 ? 'true' : 'false');
        b.addEventListener('click', function () {
          b.setAttribute('aria-pressed', b.getAttribute('aria-pressed') === 'true' ? 'false' : 'true');
          refreshSummary(card);
        });
        days.appendChild(b);
      });
      card.appendChild(days);
      var dayErr = el('div', { class: 'err' });
      dayErr.setAttribute('data-err', 'schedules[' + i + '].days');
      card.appendChild(dayErr);

      var start = el('input', { type: 'time' });
      start.setAttribute('data-k', 'start');
      start.value = sc.start;
      start.addEventListener('input', function () { refreshSummary(card); });
      var end = el('input', { type: 'time' });
      end.setAttribute('data-k', 'end');
      end.value = sc.durationMin ? JigLib.endFromDuration(sc.start, sc.durationMin) : '17:00';
      end.addEventListener('input', function () { refreshSummary(card); });
      card.appendChild(el('div', { class: 'row3' }, [labeled('Starts at', start, 'schedules[' + i + '].start'), labeled('Ends at', end, 'schedules[' + i + '].durationMin')]));
      card.appendChild(el('p', { class: 'hint when-hint', text: 'An end time earlier than the start means the next day. The same time means 24 hours.' }));

      var jitter = el('input', { inputmode: 'numeric', autocomplete: 'off', placeholder: '0' });
      jitter.setAttribute('data-k', 'jitter');
      jitter.value = sc.jitterMin ? String(sc.jitterMin) : '';
      jitter.addEventListener('input', function () { refreshSummary(card); });
      card.appendChild(labeled('Random shift (± minutes, 0 to 120)', jitter, 'schedules[' + i + '].jitterMin'));
      card.appendChild(el('p', { class: 'hint', text: 'Each time moves by a random amount up to this many minutes earlier or later, chosen afresh every day (a window’s start and end move independently).' }));

      var repeat = el('select');
      repeat.setAttribute('data-k', 'repeat');
      repeat.appendChild(el('option', { value: 'forever', text: 'Forever' }));
      repeat.appendChild(el('option', { value: 'times', text: 'Limited' }));
      repeat.value = sc.times ? 'times' : 'forever';
      repeat.addEventListener('change', function () { refreshSummary(card); });
      var times = el('input', { inputmode: 'numeric', autocomplete: 'off' });
      times.setAttribute('data-k', 'times');
      times.value = sc.times ? String(sc.times) : '1';
      if (sc.times) { times.setAttribute('data-remaining', String(sc.remaining)); times.setAttribute('data-times', String(sc.times)); }
      times.addEventListener('input', function () { refreshSummary(card); });
      card.appendChild(el('div', { class: 'row3' }, [labeled('Repeat every week', repeat, 'schedules[' + i + '].repeat'), labeled('Number of runs', times, 'schedules[' + i + '].times')]));

      var rm = el('button', { class: 'danger', type: 'button', text: 'Remove' });
      rm.onclick = function () { sched.schedules = readSchedules(); sched.schedules.splice(i, 1); renderSchedules(); };
      card.appendChild(el('div', { class: 'actions' }, [rm]));
      box.appendChild(card);
      refreshSummary(card);
    });
    $('schedEmpty').hidden = sched.schedules.length > 0;
    $('schedAdd').disabled = $('schedAddAction').disabled = sched.schedules.length >= MAX_SCHEDULES;
  }

  function loadSchedules() {
    App.call('GET', '/api/schedules').then(function (res) {
      if (res.status !== 200) return;
      sched = { schedules: res.data.schedules };
      renderSchedules();
    }).catch(function () {});
  }

  function add(kind) {
    sched.schedules = readSchedules();
    var n = 1, prefix = kind === 'action' ? 'action-' : 'window-';
    while (sched.schedules.some(function (x) { return x.id === prefix + n; })) n++;
    var base = { id: prefix + n, enabled: true, kind: kind, days: ['mon', 'tue', 'wed', 'thu', 'fri'], start: '09:00', jitterMin: 0, times: null, remaining: null };
    if (kind === 'action') base.action = 'start'; else base.durationMin = 480;
    sched.schedules.push(base);
    renderSchedules();
  }
  $('schedAdd').onclick = function () { add('window'); };
  $('schedAddAction').onclick = function () { add('action'); };

  $('schedSave').onclick = function () {
    var root = $('view-schedule');
    clearErrors($('schedList'));
    say('', '', 'schedMsg');
    App.call('PUT', '/api/schedules', { schedules: readSchedules() }).then(function (res) {
      if (res.status === 200) {
        sched = { schedules: res.data.schedules };
        renderSchedules();
        say('Schedules saved. A window that is open right now starts the jiggler.', 'good', 'schedMsg');
        App.poll();
        return;
      }
      var d = res.data;
      if (!d.field || !showError(root, d.field, d.message)) say(tr(d.message) || 'Could not save.', 'bad', 'schedMsg');
      else say('Check the highlighted fields.', 'bad', 'schedMsg');
    }).catch(function () {});
  };

  function renderClock(s) {
    var note = $('clockNote');
    if (!s.time) { note.textContent = ''; return; }
    note.textContent = 'Device clock: ' + JigLib.clockLine(s.time) + (s.schedule && s.schedule.active ? ' · a window is open now.' : '.') + ' Change the timezone or NTP server in System → Time.';
  }

  App.view('schedule', {
    load: function () {
      if (App.status()) renderClock(App.status());
      loadSchedules();
    },
    onStatus: function (s) { renderClock(s); }
  });
})();

// System: token, time, button, network, firmware update, device info, restart.
(function () {
  'use strict';
  var $ = App.$, el = App.el, say = App.say, tr = JigLib.tr;
  var clearErrors = App.clearErrors, showError = App.showError;

  // ---- Token ----
  $('tokenForm').addEventListener('submit', function (ev) {
    ev.preventDefault();
    var root = $('tokenForm');
    clearErrors(root);
    say('', '', 'tokMsg');
    var current = $('tokCurrent').value, next = $('tokNew').value, confirm = $('tokConfirm').value;
    if (!current) { showError(root, 'current', 'the current token is required'); return; }
    var problem = JigLib.checkNewToken(next, confirm);
    if (problem) { root.querySelector('[data-err="' + (next === confirm ? 'token' : 'confirm') + '"]').textContent = problem; return; }
    App.call('PUT', '/api/token', { current: current, token: next }).then(function (res) {
      if (res.status === 200) {
        App.setToken(next);
        $('tokCurrent').value = $('tokNew').value = $('tokConfirm').value = '';
        say('Token changed. This browser already uses the new one; remember to update other clients and MCP configurations.', 'good', 'tokMsg');
        return;
      }
      var d = res.data;
      if (!d.field || !showError(root, d.field, d.message)) say(tr(d.message) || 'Could not change the token.', 'bad', 'tokMsg');
    }).catch(function () {});
  });

  // ---- Time ----
  var timeDirty = false;
  function renderTimeNow(s) { if (s.time) $('timeNow').textContent = JigLib.clockLine(s.time); }
  function loadTime() {
    App.call('GET', '/api/time').then(function (res) {
      if (res.status !== 200) return;
      var sel = $('tzSelect');
      if (sel.options.length !== res.data.timezones.length) {
        sel.textContent = '';
        res.data.timezones.forEach(function (z) { sel.appendChild(el('option', { value: z, text: z.replace('_', ' ') })); });
      }
      if (!timeDirty) { sel.value = res.data.timezone; $('ntpServer').value = res.data.ntpServer; }
    }).catch(function () {});
  }
  ['tzSelect', 'ntpServer'].forEach(function (id) { $(id).addEventListener('input', function () { timeDirty = true; }); });
  $('timeSave').onclick = function () {
    var root = $('timeBox');
    clearErrors(root);
    say('', '', 'timeMsg');
    App.call('PUT', '/api/time', { timezone: $('tzSelect').value, ntpServer: $('ntpServer').value.trim() }).then(function (res) {
      if (res.status === 200) { timeDirty = false; say('Saved.', 'good', 'timeMsg'); App.poll(); return; }
      var d = res.data;
      if (!d.field || !showError(root, d.field, d.message)) say(tr(d.message) || 'Could not save.', 'bad', 'timeMsg');
    }).catch(function () {});
  };
  $('timeSet').onclick = function () {
    say('', '', 'timeMsg');
    App.call('POST', '/api/time/set', { epoch: Math.floor(Date.now() / 1000) }).then(function (res) {
      if (res.status === 200) { say('The device clock now follows this browser’s time. It is lost when the device restarts unless NTP sets it again.', 'good', 'timeMsg'); App.poll(); return; }
      say(tr(res.data && res.data.message) || 'Could not set the time.', 'bad', 'timeMsg');
    }).catch(function () {});
  };

  // ---- Button ----
  function loadButton() {
    App.call('GET', '/api/button').then(function (res) {
      if (res.status !== 200) return;
      var sel = $('btnGpio');
      if (sel.options.length !== res.data.gpios.length) {
        sel.textContent = '';
        res.data.gpios.forEach(function (g) { sel.appendChild(el('option', { value: String(g), text: 'GPIO ' + g + (g === res.data['default'] ? ' (BOOT button)' : '') })); });
      }
      sel.value = String(res.data.gpio);
    }).catch(function () {});
  }
  $('btnSave').onclick = function () {
    var root = $('buttonBox');
    clearErrors(root);
    say('', '', 'btnMsg');
    App.call('PUT', '/api/button', { gpio: Number($('btnGpio').value) }).then(function (res) {
      if (res.status === 200) { say('Saved. The button works on that pin now.', 'good', 'btnMsg'); return; }
      var d = res.data;
      if (!d.field || !showError(root, d.field, d.message)) say(tr(d.message) || 'Could not save.', 'bad', 'btnMsg');
    }).catch(function () {});
  };

  // ---- Network ----
  function loadNetwork() {
    App.call('GET', '/api/network').then(function (res) {
      $('netMode').value = res.data.mode;
      $('netSsid').value = res.data.apSsid;
      $('netPass').value = res.data.apPassword;
    }).catch(function () {});
  }
  function saveNetwork(restart) {
    var root = $('view-system');
    ['mode', 'apSsid', 'apPassword'].forEach(function (k) { root.querySelector('[data-err="' + k + '"]').textContent = ''; });
    say('', '', 'netMsg');
    App.call('PUT', '/api/network', { mode: $('netMode').value, apSsid: $('netSsid').value, apPassword: $('netPass').value }).then(function (res) {
      if (res.status === 200) {
        say(restart ? 'Saved. Restarting…' : 'Saved: applies after the next restart.', 'good', 'netMsg');
        if (restart) App.restartDevice();
        return;
      }
      var d = res.data;
      if (!d.field || !showError(root, d.field, d.message)) say(tr(d.message) || 'Could not save.', 'bad', 'netMsg');
    }).catch(function () {});
  }
  $('netSave').onclick = function () { saveNetwork(false); };
  $('netSaveRestart').onclick = function () { saveNetwork(true); };

  // ---- Firmware update (OTA) ----
  var FW_TRIES = 3;
  function uploadFirmware(file, attempt) {
    attempt = attempt || 1;
    var xhr = new XMLHttpRequest();
    var bar = $('fwProgress');
    bar.hidden = false;
    bar.value = 0;
    $('fwUpload').disabled = true;
    say('Uploading ' + Math.round(file.size / 1024) + ' KB' + (attempt > 1 ? ' (attempt ' + attempt + ' of ' + FW_TRIES + ')' : '') + '…', '', 'fwMsg');
    xhr.upload.onprogress = function (e) { if (e.lengthComputable) bar.value = Math.round((e.loaded / e.total) * 100); };
    xhr.onload = function () {
      var data = {};
      try { data = JSON.parse(xhr.responseText); } catch (e) {}
      $('fwUpload').disabled = false;
      if (xhr.status === 200) {
        bar.value = 100;
        say('Updated. Restarting…', 'good', 'fwMsg');
        App.waitForDevice();
        return;
      }
      bar.hidden = true;
      if (xhr.status === 401) say('The token was refused.', 'bad', 'fwMsg');
      else say(tr(data.message) || 'The update failed.', 'bad', 'fwMsg');
    };
    xhr.onerror = function () {
      // The radio can drop the connection mid-upload; nothing is installed until the whole file arrived, so try again.
      if (attempt < FW_TRIES) { say('The connection dropped. Trying again…', '', 'fwMsg'); setTimeout(function () { uploadFirmware(file, attempt + 1); }, 2500); return; }
      bar.hidden = true;
      $('fwUpload').disabled = false;
      say('Could not finish the upload after ' + FW_TRIES + ' attempts. Move closer to the router or try again.', 'bad', 'fwMsg');
    };
    var form = new FormData();
    form.append('firmware', file, file.name);
    xhr.open('POST', '/api/update');
    xhr.setRequestHeader('Authorization', 'Bearer ' + App.getToken());
    xhr.send(form);
  }
  App.confirmInline($('fwUpload'), 'Confirm: upload and restart', function () {
    $('e_fwFile').textContent = '';
    say('', '', 'fwMsg');
    var file = $('fwFile').files[0];
    if (!file) { $('e_fwFile').textContent = 'Choose a firmware file first.'; return; }
    if (!/\.bin$/i.test(file.name)) { $('e_fwFile').textContent = 'That does not look like a firmware file (.bin).'; return; }
    uploadFirmware(file);
  });

  // ---- Firmware updates from the repository ----
  var upd = null, updTimer = null, updDirty = false, restartWatching = false;
  var MODE_HINTS = {
    manual: 'The device looks once a day, at the time below, and tells you here and on Status. You press Install.',
    automatic: 'The device looks once a day, at the time below, and installs a new version by itself, then restarts (the jiggler and Bluetooth are off for a short while). A version that did not take effect is not retried automatically.',
    ignore: 'The device never looks by itself. You can still press Check for updates.'
  };
  function showTimeField() {
    var off = $('updMode').value === 'ignore';
    $('updTimeBox').hidden = off;
    $('updTimeHint').hidden = off;
  }
  function renderUpdates() {
    if (!upd) return;
    var d = JigLib.describeUpdate(upd);
    if (upd.current) $('updVersion').textContent = 'Running version ' + upd.current + '.';
    $('updInfo').textContent = d.text;
    $('updProgress').hidden = upd.state !== 'installing';
    $('updProgress').value = upd.progress || 0;
    $('updCheck').disabled = d.working;
    $('updInstall').hidden = !d.canInstall;
    $('updInstall').disabled = d.working;
    $('updInstall').textContent = upd.latest ? 'Install ' + upd.latest.version : 'Install';
    var notes = $('updNotes');
    notes.hidden = !(upd.latest && upd.latest.pageUrl);
    if (!notes.hidden) notes.href = upd.latest.pageUrl;
    if (!updDirty) {
      $('updMode').value = upd.mode;
      $('updRepo').value = upd.repoUrl;
      $('updTime').value = upd.checkTime;
    }
    $('updModeHint').textContent = MODE_HINTS[$('updMode').value] || '';
    showTimeField();
    var repoLink = $('infoRepo');
    repoLink.href = upd.repoUrl;
    repoLink.textContent = JigLib.repoLabel(upd.repoUrl);
    if (upd.state === 'restarting' && !restartWatching) { restartWatching = true; App.waitForDevice(); }
    clearTimeout(updTimer);
    // An install leaves the device almost no memory: ask three times less often than for a check.
    if (d.working && !$('view-system').hidden) updTimer = setTimeout(loadUpdates, upd.state === 'installing' ? 4500 : 1500);
  }
  function loadUpdates() {
    App.call('GET', '/api/updates').then(function (res) {
      if (res.status !== 200) return;
      upd = JigLib.mergeUpdate(upd, res.data);  // while installing the device answers with state and progress only
      renderUpdates();
    }).catch(function () {});
  }
  ['updMode', 'updRepo', 'updTime'].forEach(function (id) {
    $(id).addEventListener('input', function () { updDirty = true; $('updModeHint').textContent = MODE_HINTS[$('updMode').value] || ''; showTimeField(); });
  });
  $('updCheck').onclick = function () {
    say('', '', 'updMsg');
    App.call('POST', '/api/updates/check').then(function (res) {
      if (res.status === 202) { upd = res.data; renderUpdates(); updTimer = setTimeout(loadUpdates, 800); return; }
      say(tr(res.data && res.data.message) || 'Could not start the check.', 'bad', 'updMsg');
    }).catch(function () {});
  };
  App.confirmInline($('updInstall'), 'Confirm: install and restart', function () {
    say('', '', 'updMsg');
    App.call('POST', '/api/updates/install').then(function (res) {
      if (res.status === 202) { upd = res.data; renderUpdates(); updTimer = setTimeout(loadUpdates, 800); return; }
      say(tr(res.data && res.data.message) || 'Could not start the install.', 'bad', 'updMsg');
    }).catch(function () {});
  });
  function saveUpdates(repoOverride) {
    var root = $('updBox');
    clearErrors(root);
    say('', '', 'updSaveMsg');
    var body = { mode: $('updMode').value, repoUrl: repoOverride !== undefined ? repoOverride : $('updRepo').value.trim() };
    if ($('updTime').value) body.checkTime = $('updTime').value;
    App.call('PUT', '/api/updates', body).then(function (res) {
      if (res.status === 200) { updDirty = false; upd = res.data; renderUpdates(); say('Saved.', 'good', 'updSaveMsg'); App.poll(); return; }
      var d = res.data;
      if (!d.field || !showError(root, d.field, d.message)) say(tr(d.message) || 'Could not save.', 'bad', 'updSaveMsg');
    }).catch(function () {});
  }
  $('updSave').onclick = function () { saveUpdates(); };
  $('updReset').onclick = function () { saveUpdates(''); };

  // ---- Device info and restart ----
  function renderInfo(s) {
    if (!s.device) return;
    $('infoVersion').textContent = s.device.version;
    $('infoName').textContent = s.device.bleName;
    $('infoAddress').textContent = s.device.bleAddress;
  }
  App.confirmInline($('restartBtn'), 'Confirm: restart', function () { say('', '', 'sysMsg'); App.restartDevice(); });

  App.view('system', {
    load: function () { loadNetwork(); loadTime(); loadButton(); loadUpdates(); if (App.status()) { renderInfo(App.status()); renderTimeNow(App.status()); } },
    onStatus: function (s) { renderInfo(s); renderTimeNow(s); }
  });
})();

// Boot: login, routing, polling.
(function () {
  'use strict';
  var $ = App.$;

  $('tokenShow').addEventListener('change', function () { $('tokenInput').type = $('tokenShow').checked ? 'text' : 'password'; });
  $('loginForm').addEventListener('submit', function (ev) {
    ev.preventDefault();
    var t = $('tokenInput').value.trim();
    if (!t) { $('loginErr').textContent = 'Enter the token.'; return; }
    App.setToken(t);
    $('login').hidden = true;
    App.poll();
    App.reloadCurrent();
  });

  window.addEventListener('hashchange', App.route);
  document.addEventListener('visibilitychange', function () { if (!document.hidden) App.poll(); });

  App.route();
  document.documentElement.setAttribute('data-ready', '1');
  if (!App.getToken()) App.showLogin('');
  App.poll();
  setInterval(App.poll, 1000);
  setInterval(App.tick, 250);
})();
</script>
</body>
</html>
)HTML";
